/*@!Encoding:65001*/
includes
{
  
}

variables
{
  int isSleeping = 1; // 초기 상태는 절전
  msTimer loop;
  int timerCnt = 0;
}

// 0. 시뮬레이션 시작 시 절전 진입
on start
{
  isSleeping = 1;
  write("VCU: Sleep mode entered.");
  setTimerCyclic(loop, 10);
}

// 0. Run 상태에서 보낼 주기 메세지
on timer loop
{
  if(isSleeping == 0)
  {
    message VCU_AccPedal_CTL_10MSG acc_msg;
    message VCU_BrakePedal_CTL_10MSG brk_msg;
    message VCU_VehicleStart_STATUS_100MSG ign_msg;
    message VCU_Transmission_STATUS_1000MSG trans_msg;
    
    timerCnt++;
    
    acc_msg.Accel_Pedal_Pos = @sysvar::FRONT::VCU::Accel_Pedal;
    brk_msg.Brake_Pedal_Pos = @sysvar::FRONT::VCU::Brake_Pedal;
    output(acc_msg);
    output(brk_msg);
    
    if(timerCnt % 10 == 0){
      ign_msg.Ignition_Status = @sysvar::FRONT::VCU::Ignition;
      output(ign_msg);
    }
    
    if(timerCnt % 100 == 0){
      trans_msg.Drive_Mode = @sysvar::FRONT::VCU::Drive_Mode;
      trans_msg.Gear_Position = @sysvar::FRONT::VCU::Gear;
      output(trans_msg);
      timerCnt = 0;
    }

  }
}

// 1. FZCU_WakeUp_CTL_MSG 메시지 수신 시 VCU 깨움
on message FZCU_WakeUp_CTL_MSG
{
  if (isSleeping)
  {
    isSleeping = 0;
    write("VCU: Wake-up triggered by CAN message.");
    // VCU_Alive 시그널 -> 1 : IL 메시지 전송 시작 (주기적 전송 포함)
    $VCU_Alive = 1;
  }
}

// 2. 시동 ON/OFF
on sysvar sysvar::FRONT::VCU::Ignition
{
  if(isSleeping){
    message VCU_VehicleStart_STATUS_100MSG ign_msg;
    ign_msg.Ignition_Status = @this;
    output(ign_msg);
  }
}
