/*@!Encoding:65001*/
includes
{
  
}

variables
{
  int isSleeping = 1; // 초기 상태는 절전
  msTimer loop;
}

// 0. 시뮬레이션 시작 시 절전 진입
on start
{
  isSleeping = 1;
  write("ABS: Sleep mode entered.");
  setTimerCyclic(loop, 10);
}

// 0. Run 상태에서 보낼 주기 메세지
on timer loop
{
  if(isSleeping == 0)
  {
    message ABS_BrakeOutput_STATUS_10MSG Brake_msg;
    Brake_msg.Brake_Output = @`FRONT::`ABS::BrakeStatus;
    output(Brake_msg);
  }
}

// 1. FZCU_WakeUp_CTL_MSG 메시지 수신 시 ABS 깨움
on message FZCU_WakeUp_CTL_MSG
{
  if (isSleeping)
  {
    isSleeping = 0;
    write("ABS: Wake-up triggered by CAN message.");
    // ABS_Alive 시그널 -> 1 : IL 메시지 전송 시작 (주기적 전송 포함)
    $ABS_Alive = 1;
    
  }
}

// 2. FZCU 브레이크 컨트롤 메세지 수신 시 브레이크 페달 
on message FZCU_Brake_CTL_10MSG
{
  if(isSleeping == 0)
  {
    write("Brake Pedal change");
    @sysvar::`FRONT::`ABS::BrakeStatus = this.Brake_Control;
  }
}
