/*@!Encoding:65001*/
includes
{
  
}

variables
{
  
}

testcase MainTest(){
 write(""); 
  
}