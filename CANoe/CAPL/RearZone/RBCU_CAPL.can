/*@!Encoding:65001*/
includes
{
  
}

variables
{
  byte EmergencyFlag = 0;
  int isSleeping = 1; // 초기 상태는 절전
  msTimer loop;
  int timerCnt = 0;
}

// 0. 시뮬레이션 시작 시 절전 진입
on start
{
  EmergencyFlag = 0;
  isSleeping = 1;
  write("RBCU: Sleep mode entered.");
  setTimerCyclic(loop, 100);
}

// 0. Run 상태에서 보낼 주기 메세지
on timer loop
{
  if(isSleeping == 0)
  {
    message RBCU_TailLamp_STATUS_100MSG lampStatus_msg;
    lampStatus_msg.LeftRear_TurnSignal_Status = @sysvar::REAR::RBCU::LR_TurnSignalLight;
    lampStatus_msg.RightRear_TurnSignal_Status = @sysvar::REAR::RBCU::RR_TurnSignalLight;
    lampStatus_msg.Brake_Light_Status = @sysvar::REAR::RBCU::BrakeLight;
    output(lampStatus_msg);
  }
}

// 1. RZCU_WakeUp_CTL_MSG 메시지 수신 시 RBCU 깨움
on message RZCU_WakeUp_CTL_MSG
{
  if (isSleeping)
  {
    isSleeping = 0;
    write("RBCU: Wake-up triggered by CAN message.");
    // RBCU_Alive 시그널 -> 1 : IL 메시지 전송 시작 (주기적 전송 포함)
    $RBCU_Alive = 1;
  }
}

// 2. RZCU_TurnLight_CTL_MSG 메시지 수신 시 시스템 변수 변경 - 방향 지시등
on message RZCU_TurnLight_CTL_MSG
{
  if(isSleeping == 0)
  {
    if(EmergencyFlag==0){
      @sysvar::REAR::RBCU::LR_TurnSignalLight = this.LeftRear_Light;  
      @sysvar::REAR::RBCU::RR_TurnSignalLight = this.RightRear_Light;    
      write("RZCU_TurnLight_CTL_MSG [%d] [%d]", this.LeftRear_Light.phys, this.RightRear_Light.phys);
    }
  }
}

// 3. RZCU_BrakeLight_CTL_MSG 메시지 수신 시 시스템 변수 변경 - 방향 지시등
on message RZCU_BrakeLight_CTL_MSG
{
  if(isSleeping == 0)
  {
    @sysvar::REAR::RBCU::BrakeLight = this.Rear_BrakeLight;
  }
}

on message RZCU_OTA_RBCU_MSG
{
  message RBCU_OTAResult_STATUS_MSG rbcu_otaresult_status_msg;
  rbcu_otaresult_status_msg.RBCU_OTAResult = 1;
  output(rbcu_otaresult_status_msg);
  write("RBCU OTA COMPLETED");
}

on message RZCU_EmergencyOnOff_CTL_MSG
{
  EmergencyFlag = this.Emergency_Light;
  @sysvar::REAR::RBCU::LR_TurnSignalLight = this.Emergency_Light;  
  @sysvar::REAR::RBCU::RR_TurnSignalLight = this.Emergency_Light;  
  write("EmgergencyFlag : %d", EmergencyFlag);
}
