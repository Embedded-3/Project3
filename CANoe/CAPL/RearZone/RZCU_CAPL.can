/*@!Encoding:65001*/
includes
{
  #include "../includes/eth_frame.can"
}

variables
{
  msTimer loop10ms;
  msTimer loop20ms;
  msTimer loopFlagInit5ms;
  
  int counter_10ms;
  int counter_20ms;
  
  byte wakeupFlag; // 0 : sleep 1 : wakeup
  
  int port_id;
  int allcan_port_id;
  
  ethernetPacket globalEthPkt;
  
  ethernetPacket UssUdpMsg;
  ethernetPacket WheelInfoUdpMsg;
  ethernetPacket OtaResultUdpMsg;
  ethernetPacket AliveUdpMsg;
  ethernetPacket TailLampUdpMsg;
  
  // TX FRAME
  struct RearHpcUssFrame rearHpcUss10msFrame;
  struct RearHpcWheelInfoFrame rearHpcWheelInfo10msFrame;
  struct RearHpcOtaResultFrame rearHpcOtaResultFrame;
  struct RearMiddleAliveFrame rearMiddleAlive20msFrame;
  struct RearMiddleTailLampStatusFrame rearMiddleTailLampStatus20msFrame;
  
  // RX FRAME
  struct HpcRearOtaRearFrame rxOtaRearFrame;
  struct FrontRearHeadLampRearFrame rxHeadLampRearFrame;
  struct FrontRearMcuControlFrame rxMcuControlFrame;
  struct MiddleRearEmergencyOnOffFrame rxEmergencyOnOffFrame;
  
  // RX FRAME(ALL)
  struct HpcAllEsaFrame rxEsaFrame;
  struct HpcAllWakeUpFrame rxWakeUpFrame;
  
  byte OtaRearFrameReceived10ms;
  byte HeadLampRearFrameReceived20ms;
  byte McuControlFrameReceived20ms;
  
  byte EsaFrameReceived20ms;
  byte WakeUpReceived;
  byte EmergencyOnOffReceived;
  
  // CAN RX Signal
  byte rxCanLeftRear_TurnSignal_Status;
  byte rxCanRightRear_TurnSignal_Status;
  byte rxCanBrake_Light_Status;
  
  int rxCanLeftRear_MotorRPM;
  int rxCanRightRear_MotorRPM;
  
  byte rxCanLeftRear_UltraSoundVal;
  byte rxCanRightRear_UltraSoundVal;
    // RZCU	RBCU USS MCU
  byte rxCanRBCU_Alive;
  byte rxCanUSS_Alive;
  byte rxCanMCU_Alive;
  
  int i, j;
  qword ota_value;
  
  // TX CAN MESSAGE
  message RZCU_OTA_MCU_MSG rzcu_ota_mcu_msg;
  message RZCU_OTA_RBCU_MSG rzcu_ota_rbcu_msg;
  message RZCU_OTA_USS_MSG rzcu_ota_uss_msg;
  
  message RZCU_TurnLight_CTL_MSG rzcu_turnlight_ctl_msg;
  message RZCU_BrakeLight_CTL_MSG rzcu_brakelight_ctl_msg;
  message RZCU_Wheel_CTL_MSG rzcu_wheel_ctl_msg;
  message RZCU_WakeUp_CTL_MSG rzcu_wakeup_ctl_msg;
  message RZCU_VehicleStart_CTL_MSG rzcu_vehiclestart_ctl_msg;
  
  message RZCU_EmergencyOnOff_CTL_MSG rzcu_emergencyonoff_ctl_msg;
  
  // TX CAN SIGNAL
  byte txCanLeftRear_Light;
  byte txCanRightRear_Light;
  byte txCanRear_BrakeLight;
  byte txCanObstacleDetection_Distance;
  int txCanLeftRear_RPM;
  int txCanRightRear_RPM;
  byte txCanIgnition_Status;
  byte txCanRearZone_WakeUp;
  byte txCanEmergencyOnOff;
  
}

on start
{
  counter_10ms = 0;
  counter_20ms = 0;
  wakeupFlag = 0;
  
  OtaRearFrameReceived10ms = 0;
  HeadLampRearFrameReceived20ms = 0;
  McuControlFrameReceived20ms = 0;
  EsaFrameReceived20ms = 0;
  WakeUpReceived = 0;
  EmergencyOnOffReceived = 0;
  
  rxCanLeftRear_MotorRPM = 0;
  rxCanRightRear_MotorRPM = 0;
  rxCanLeftRear_UltraSoundVal = 0;
  rxCanRightRear_UltraSoundVal = 0;
  
  rxCanRBCU_Alive = 0;
  rxCanUSS_Alive = 0;
  rxCanMCU_Alive = 0;
  
  setTimerCyclic(loop10ms, 10); // 10ms
  setTimerCyclic(loop20ms, 20); // 20ms
  setTimerCyclic(loopFlagInit5ms, 5);
  
  initUdpPacket(RZCU_MAC_ADDR, HPC_MAC_ADDR, RZCU_IP_ADDR, HPC_IP_ADDR,
            REAR_TX_PORT_BASE, HPC_RX_PORT_BASE, REAR_USS_TX_PORT_ID, HPC_USS_RX_PORT_ID);
  UssUdpMsg = globalEthPkt;
  
  initUdpPacket(RZCU_MAC_ADDR, HPC_MAC_ADDR, RZCU_IP_ADDR, HPC_IP_ADDR,
            REAR_TX_PORT_BASE, HPC_RX_PORT_BASE, REAR_WHEEL_INFO_TX_PORT_ID, HPC_WHEEL_INFO_RX_PORT_ID);
  WheelInfoUdpMsg = globalEthPkt;
  
  initUdpPacket(RZCU_MAC_ADDR, HPC_MAC_ADDR, RZCU_IP_ADDR, HPC_IP_ADDR,
            REAR_TX_PORT_BASE, HPC_RX_PORT_BASE, REAR_OTARESULT_TX_PORT_ID, HPC_OTARESULT_REAR_RX_PORT_ID);
  OtaResultUdpMsg = globalEthPkt;
  
  initUdpPacket(RZCU_MAC_ADDR, MZCU_MAC_ADDR, RZCU_IP_ADDR, MZCU_IP_ADDR,
            REAR_TX_PORT_BASE, MIDDLE_RX_PORT_BASE, REAR_ALIVE_TX_PORT_ID, MIDDLE_ALIVE_REAR_RX_PORT_ID);
  AliveUdpMsg = globalEthPkt;
  
  initUdpPacket(RZCU_MAC_ADDR, MZCU_MAC_ADDR, RZCU_IP_ADDR, MZCU_IP_ADDR,
            REAR_TX_PORT_BASE, MIDDLE_RX_PORT_BASE, REAR_TAILLAMP_TX_PORT_ID, MIDDLE_TAILLAMP_RX_PORT_ID);
  TailLampUdpMsg = globalEthPkt;
}

on message RBCU_TailLamp_STATUS_100MSG
{
  rxCanLeftRear_TurnSignal_Status = this.LeftRear_TurnSignal_Status;
  rxCanRightRear_TurnSignal_Status = this.RightRear_TurnSignal_Status;
  rxCanBrake_Light_Status = this.Brake_Light_Status;
}

on message MCU_RearMotor_STATUS_10MSG
{
  rxCanLeftRear_MotorRPM = this.LeftRear_MotorRPM;
  rxCanRightRear_MotorRPM = this.RightRear_MotorRPM;
}

on message RBCU_Alive_INFO_20MSG
{
  rxCanRBCU_Alive = this.RBCU_Alive;
}

on message USS_Alive_INFO_20MSG
{
  rxCanUSS_Alive = this.USS_Alive;
}

on message MCU_Alive_INFO_20MSG
{
  rxCanMCU_Alive = this.MCU_Alive;
}

on message RBCU_OTAResult_STATUS_MSG
{
  rearHpcOtaResultFrame.ECU_OTA_Result = (1 << 6);
  OtaResultUdpMsg.udp.SetData(0, rearHpcOtaResultFrame);
  OtaResultUdpMsg.CompletePacket();
  output(OtaResultUdpMsg);
  write("[rbcu->rzcu->hpc] ota result commited");
}

on message USS_OTAResult_STATUS_MSG
{
  rearHpcOtaResultFrame.ECU_OTA_Result = (1 << 5);
  OtaResultUdpMsg.udp.SetData(0, rearHpcOtaResultFrame);
  OtaResultUdpMsg.CompletePacket();
  output(OtaResultUdpMsg);
  write("[uss->rzcu->hpc] ota result commited");
}

on message MCU_OTAResult_STATUS_MSG
{
  rearHpcOtaResultFrame.ECU_OTA_Result = (1 << 4);
  OtaResultUdpMsg.udp.SetData(0, rearHpcOtaResultFrame);
  OtaResultUdpMsg.CompletePacket();
  output(OtaResultUdpMsg);
  write("[mcu->rzcu->hpc] ota result commited");
}

on message USS_UltraSoundVal_INFO_50MSG
{
  rxCanLeftRear_UltraSoundVal = this.LeftRear_UltraSoundVal;
  rxCanRightRear_UltraSoundVal = this.RightRear_UltraSoundVal;
}

on timer loopFlagInit5ms
{
  if(wakeupFlag == 0) return;
  OtaRearFrameReceived10ms = 0;
  HeadLampRearFrameReceived20ms = 0;
  McuControlFrameReceived20ms = 0;
  EsaFrameReceived20ms = 0;
  WakeUpReceived = 0;
  EmergencyOnOffReceived = 0;
}

on timer loop10ms
{  
  if(wakeupFlag == 0) return;
  counter_10ms++;
  
  rearHpcUss10msFrame.LeftRear_UltraSoundVal = rxCanLeftRear_UltraSoundVal;
  rearHpcUss10msFrame.RightRear_UltraSoundVal = rxCanRightRear_UltraSoundVal;
  UssUdpMsg.udp.SetData(0, rearHpcUss10msFrame);
  UssUdpMsg.CompletePacket();
  output(UssUdpMsg);
  write("[TX] [rear->hpc] uss msg sent at %d ms", 10 * counter_10ms);
  
  rearHpcWheelInfo10msFrame.LeftRear_MotorRPM = rxCanLeftRear_MotorRPM;
  rearHpcWheelInfo10msFrame.LeftRear_MotorDirection = 0;
  rearHpcWheelInfo10msFrame.RightRear_MotorRPM = rxCanRightRear_MotorRPM;
  rearHpcWheelInfo10msFrame.RightRear_MotorDirection = 0;
  WheelInfoUdpMsg.udp.SetData(0, rearHpcWheelInfo10msFrame);
  WheelInfoUdpMsg.CompletePacket();
  output(WheelInfoUdpMsg);
  write("[TX] [rear->hpc] wheel info msg sent at %d ms", 10 * counter_10ms);
}

on timer loop20ms
{
  if(wakeupFlag == 0) return;
  counter_20ms++;
  
  // RZCU	RBCU USS MCU
  rearMiddleAlive20msFrame.ECU_Alive_Status = 0;
  rearMiddleAlive20msFrame.ECU_Alive_Status |= (1 << 7);
  rearMiddleAlive20msFrame.ECU_Alive_Status |= rxCanRBCU_Alive ? (1 << 6) : 0;
  rearMiddleAlive20msFrame.ECU_Alive_Status |= rxCanUSS_Alive ? (1 << 5) : 0; 
  rearMiddleAlive20msFrame.ECU_Alive_Status |= rxCanUSS_Alive ? (1 << 4) : 0;
  AliveUdpMsg.udp.SetData(0, rearMiddleAlive20msFrame);
  AliveUdpMsg.CompletePacket();
  output(AliveUdpMsg);
  write("[TX] [rear->middle] can alive msg sent at %d ms", 20 * counter_20ms);
  
  rearMiddleTailLampStatus20msFrame.Brake_Light_Status = rxCanBrake_Light_Status; // need to connect
  rearMiddleTailLampStatus20msFrame.LeftRear_TurnSignal_Status = rxCanLeftRear_TurnSignal_Status; // need to connect
  rearMiddleTailLampStatus20msFrame.RightRear_TurnSignal_Status = rxCanRightRear_TurnSignal_Status; // need to connect
  TailLampUdpMsg.udp.SetData(0, rearMiddleTailLampStatus20msFrame);
  TailLampUdpMsg.CompletePacket();
  output(TailLampUdpMsg);
  write("[TX] [rear->middle] tail lamp msg sent at %d ms", 20 * counter_20ms);
  
  
}

on ethernetPacket *
{
  ip_Endpoint endPointDst;

  this.GetDestinationIPEndpoint(endPointDst);
  
  port_id = (int)(endPointDst.PortNumber - REAR_RX_PORT_BASE);
  allcan_port_id = (int)(endPointDst.PortNumber - ALLCAN_RX_PORT_BASE);
  
  switch(allcan_port_id)
  {
    case ALLCAN_ESA_RX_PORT_ID:
      if(EsaFrameReceived20ms) return;
      EsaFrameReceived20ms = 1;
      this.udp.getData(0, rxEsaFrame);
      write("[RX] [hpc->rear] ESA BrakeLight_CTL : %d", rxEsaFrame.BrakeLight_CTL);
      txCanRear_BrakeLight = rxEsaFrame.BrakeLight_CTL;
      break;
    case ALLCAN_WAKEUP_RX_PORT_ID:
      if(WakeUpReceived) return;
      WakeUpReceived = 1;
      this.udp.getData(0, rxWakeUpFrame);
      wakeupFlag = 1;
      write("[RX] [hpc->rear] Wake up message called");
      
      // rear ecu all wake up msg send
      txCanRearZone_WakeUp = 1;
      rzcu_wakeup_ctl_msg.RearZone_WakeUp = txCanRearZone_WakeUp;
      output(rzcu_wakeup_ctl_msg);
      write("[rzcu -> peripherals] wake up message sent");
      
      //vehicle start can msg send
      txCanIgnition_Status = 3; // START
      rzcu_vehiclestart_ctl_msg.Ignition_Status = txCanIgnition_Status;
      output(rzcu_vehiclestart_ctl_msg);
      write("[rzcu -> rearzone] ignition Status = %u", rzcu_vehiclestart_ctl_msg.Ignition_Status);
      break;
    default:
      break;
  }
  
  switch(port_id)
  {
    case REAR_OTAREAR_RX_PORT_ID:
      if (OtaRearFrameReceived10ms) break;
      OtaRearFrameReceived10ms = 1;
      this.udp.GetData(0, rxOtaRearFrame);
      write("[RX] [hpc->rear] OTA REAR GOGO");
      
      for (i = 0; i < rxOtaRearFrame.Total_Byte; i += 8)
      {
        ota_value = 0;
        for (j = 0; j < 8; j++)
        {
          if (rxOtaRearFrame.Total_Byte - i < j) break;
          ota_value |= rxOtaRearFrame.Data[i+j];
          if (j != 7) ota_value = (ota_value << 8); // Endian 계산 정확한지 모르겠음.
        }
            
        // RZCU	RBCU USS MCU
        switch(rxOtaRearFrame.ECU_Select)
        {
          case (1 << 7): // RZCU
            break;
          case (1 << 6): // RBCU
            rzcu_ota_rbcu_msg.RBCU_OTA = ota_value;
            output(rzcu_ota_rbcu_msg);
            break;
          case (1 << 5): // USS
            rzcu_ota_uss_msg.USS_OTA = ota_value;
            output(rzcu_ota_uss_msg);
            break;
          case (1 << 4): // MCU
            rzcu_ota_mcu_msg.MCU_OTA = ota_value;
            output(rzcu_ota_mcu_msg);
            break;
          default:
            break;
        }
      }
      break;
    case REAR_HEADLAMP_REAR_RX_PORT_ID:
      if (HeadLampRearFrameReceived20ms) break;
      HeadLampRearFrameReceived20ms = 1;
      this.udp.GetData(0, rxHeadLampRearFrame);
      write("[RX] [front->rear] headlamp rear status : %d", rxHeadLampRearFrame.HeadLamp_Rear_Status);
      
      txCanLeftRear_Light = (rxHeadLampRearFrame.HeadLamp_Rear_Status & (1 << 7)) >> 7;
      txCanRightRear_Light = (rxHeadLampRearFrame.HeadLamp_Rear_Status & (1 << 6)) >> 6;
      rzcu_turnlight_ctl_msg.LeftRear_Light = txCanLeftRear_Light;
      rzcu_turnlight_ctl_msg.RightRear_Light = txCanRightRear_Light;
      write("TESTMSG : LAMPSTATE LEFT %d, RIGHT %d", rzcu_turnlight_ctl_msg.LeftRear_Light, rzcu_turnlight_ctl_msg.RightRear_Light);
      output(rzcu_turnlight_ctl_msg);
      
      txCanRear_BrakeLight |= (rxHeadLampRearFrame.HeadLamp_Rear_Status & (1 << 5)) >> 5; // ADB로 인한 brake light가 우선이므로 or 처리했음.
      rzcu_brakelight_ctl_msg.Rear_BrakeLight = txCanRear_BrakeLight;
      output(rzcu_brakelight_ctl_msg);
      
      break;
    case REAR_MCUCONTROL_RX_PORT_ID:
      if (McuControlFrameReceived20ms) break;
      McuControlFrameReceived20ms = 1;
      this.udp.GetData(0, rxMcuControlFrame);
      write("[RX] [hpc->rear] left : %d, right : %d", rxMcuControlFrame.LeftRear_RPM, rxMcuControlFrame.RightRear_RPM);
      txCanLeftRear_RPM = rxMcuControlFrame.LeftRear_RPM;
      txCanRightRear_RPM = rxMcuControlFrame.RightRear_RPM;
      break;
      
    case REAR_EMERGENCY_RX_PORT_ID:
      if(EmergencyOnOffReceived) break;
      EmergencyOnOffReceived = 1;
      this.udp.GetData(0, rxEmergencyOnOffFrame);     
      write("[RX] [middle->rear] rxEmergencyOnOff : %d", rxEmergencyOnOffFrame.Emergency_Light);
      txCanEmergencyOnOff = rxEmergencyOnOffFrame.Emergency_Light;
      rzcu_emergencyonoff_ctl_msg.Emergency_Light = txCanEmergencyOnOff;
      output(rzcu_emergencyonoff_ctl_msg);

      break;
      
    default:
      break;
  }
}


void initUdpPacket(char TX_MAC_ADDR[], char RX_MAC_ADDR[],
                  char TX_IP_ADDR[], char RX_IP_ADDR[],
                  long TX_PORT_BASE, long RX_PORT_BASE,
                  long TX_PORT_ID, long RX_PORT_ID)
{
  globalEthPkt.source = ethGetMacAddressAsNumber(TX_MAC_ADDR);
  globalEthPkt.destination = ethGetMacAddressAsNumber(RX_MAC_ADDR);
  globalEthPkt.udp.init();
  globalEthPkt.type = 0x0800;
  globalEthPkt.Length = 104;
  globalEthPkt.udp.length = 64;
  globalEthPkt.ipv4.source.ParseAddress(TX_IP_ADDR);
  globalEthPkt.ipv4.destination.ParseAddress(RX_IP_ADDR);
  globalEthPkt.udp.source = TX_PORT_BASE + TX_PORT_ID;
  globalEthPkt.udp.destination = RX_PORT_BASE + RX_PORT_ID;

  /*
  이후 해야할 일
  struct myFrame 초기화
  ethpkt->setData(0, myFrame);
  ethpkt->Length = (length); (OTA는 길게 해야함)
  ethpkt->CompletePacket();
  output(*ethpkt)
  */
}