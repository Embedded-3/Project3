/*@!Encoding:65001*/
includes
{
  
}

variables
{
  int engineState = 0;//0: OFF, 1: ACC 2: ON 3: START
  msTimer loop;
  /*
  int targetRpm = 800;
  int maxRpm = 4000;
  */
  
  //---------CAN TX-----------
  int rpm;
  int velocity;
  int transition;

  message MCU_RearMotor_STATUS_10MSG motor_msg; // rpm velocity transition
  message MCU_OTAResult_STATUS_MSG mcu_otaresult_status_msg;  
  
}

// 0. 시뮬레이션 시작 시 절전 진입
on start
{
  engineState = 0;
  
  rpm = 0;
  velocity = 0;
  transition = 0;
  write("MCU: Sleep mode entered.");
  setTimerCyclic(loop, 20);
}

// 0. Run 상태에서 보낼 주기 메세지
on timer loop
{
  if(engineState)
  {
    motor_msg.MCU_Velocity = velocity; 
    motor_msg.VCU_RPM = rpm;
    output(motor_msg);
    write("MCU : [CAN TX] velocity: %d, rpm : %d", velocity, rpm);
  }
}

on message RZCU_OTA_MCU_MSG
{
  if(engineState)
  {
    mcu_otaresult_status_msg.MCU_OTAResult = 1;
    output(mcu_otaresult_status_msg);
    write("MCU OTA COMPLETED"); 
  }
}


// 1. RZCU_WakeUp_CTL_MSG 메시지 수신 시 MCU 깨움
on message RZCU_WakeUp_CTL_MSG
{
  if (this.RearZone_WakeUp)
  {
    engineState = 1;
    write("MCU: Wake-up triggered by CAN message.");
    // MCU_Alive 시그널 -> 1 : IL 메시지 전송 시작 (주기적 전송 포함)
    $MCU_Alive = 1; 
  }else if(!this.RearZone_WakeUp)
  {
    engineState = 0;
    write("MCU: Sleep triggered by CAN message.");
    // MCU_Alive 시그널 -> 0 : IL 메시지 전송 멈춤
    $MCU_Alive = 0;
  }
}

// 2. RZCU_Wheel_CTL_10MSG 메세지 수신 시 RPM 시스템 변수 변경
on message RZCU_Wheel_CTL_MSG
{
  if(engineState)
  {
    rpm =  this.RPM_CTL;
    transition = this.Transition_Status;
    // 속도 계산로직 
    velocity = (rpm * 270) / 4000;
  }
}
