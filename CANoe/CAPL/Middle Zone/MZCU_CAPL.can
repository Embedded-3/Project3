/*@!Encoding:65001*/
includes
{
  #include "../includes/eth_frame.can"
}

variables
{
  msTimer loop20ms;
  msTimer loopFlagInit5ms;
  
  int counter_20ms;
  
  byte wakeupFlag; // 0 : sleep 1 : wakeup
  byte soundFlag;  // 0 : off   1 : on
  int  OBDistance;
  
  int port_id;
  int allcan_port_id;
  
  ethernetPacket globalEthPkt;
  
  ethernetPacket OtaAssignRejectUdpMsg;
  ethernetPacket OtaResultUdpMsg;
  ethernetPacket HeadLampStatusUdpMsg;
  ethernetPacket CanBusAliveUdpMsg;
  
  //CAN MSG
  message MZCU_HLamp_CTL_MSG headlamp_msg;
  message MZCU_ADB_Lamp_CTL_MSG adb_ctl_msg;
  message MZCU_MotorRPM_INFO_20MSG motor_ctl_msg;
  
  // TX FRAME
  struct MiddleHpcOtaAssignRejectFrame middleHpcOtaAssignRejectFrame;
  struct MiddleHpcOtaResultFrame middleHpcOtaResultFrame;
  struct MiddleHpcHeadLampStatusFrame middleHpcHeadLampStatus20msFrame;
  struct MiddleHpcCanBusAliveFrame middleHpcCanBusAlive20msFrame;
  
  // RX FRAME
  struct HpcMiddleAdbFrame rxAdbFrame;
  struct HpcMiddleOtaMiddleFrame rxOtaMiddleFrame;
  struct FrontMiddleHeadLampMiddleFrame rxHeadLampMiddleFrame;
  struct FrontMiddleAliveFrame rxFrontAliveFrame;
  struct RearMiddleAliveFrame rxRearAliveFrame;
  struct RearMiddleTailLampStatusFrame rxTailLampStatusFrame;
  struct HpcMiddleRpmInfoFrame rxRpmInfoFrame;
  
  // RX FRAME(ALL)
  struct HpcAllEsaFrame rxEsaFrame;
  struct HpcAllWakeUpFrame rxWakeUpFrame;
  
  byte AdbFrameReceived20ms;
  byte OtaMiddleFrameReceived10ms;
  byte HeadLampMiddleFrameReceived10ms;
  byte AliveFrontFrameReceived20ms;
  byte AliveRearFrameReceived20ms;
  byte TailLampFrameReceived20ms;
  byte RpmInfoFrameReceived20ms;
  
  byte EsaFrameReceived20ms;
  byte WakeUpReceived;
  
  //===============MIDDLE ZCU VARIABLES====================//
  byte FrontCanAliveState;
  byte MiddleCanAliveState;
  byte RearCanAliveState;
  
  byte rxCanHVAC_Alive;
  byte rxCanHU_Alive;
  byte rxCanCLU_Alive;
  byte rxCanMBCU_Alive;
  
  // MBCU RX can message
    // MBCU_TurnLight_STATUS_100MSG
  byte rxCanLeftFront_Light;
  byte rxCanRightFront_Light;
    // MBCU_BrakeLight_STATUS_100MSG
  byte rxCanBrake_Light;
    // MBCU_LowBeam_STATUS_100MSG
  byte rxCanLowBeam_OnOff;
    // MBCU_HighBeam_STATUS_100MSG 
  byte rxCanHighBeam_OnOff;
  byte rxCanLeft_HighBeam_Status;
  byte rxCanRight_HighBeam_Status;

}

on start 
{
  counter_20ms = 0;
  wakeupFlag = 0;
  soundFlag = 0;
  OBDistance = 255;
  
  AdbFrameReceived20ms = 0;
  OtaMiddleFrameReceived10ms = 0;
  HeadLampMiddleFrameReceived10ms = 0;
  AliveFrontFrameReceived20ms = 0;
  AliveRearFrameReceived20ms = 0;
  TailLampFrameReceived20ms = 0;
  EsaFrameReceived20ms = 0;
  WakeUpReceived = 0;
  RpmInfoFrameReceived20ms = 0;

  setTimerCyclic(loopFlagInit5ms, 5);
  setTimerCyclic(loop20ms, 20);
  
  initUdpPacket(MZCU_MAC_ADDR, HPC_MAC_ADDR, MZCU_IP_ADDR, HPC_IP_ADDR,
                MIDDLE_TX_PORT_BASE, HPC_RX_PORT_BASE, 
                MIDDLE_OTA_ASSIGN_REJECT_TX_PORT_ID, HPC_OTA_ASSIGN_REJECT_RX_PORT_ID);
  OtaAssignRejectUdpMsg = globalEthPkt;
  
  initUdpPacket(MZCU_MAC_ADDR, HPC_MAC_ADDR, MZCU_IP_ADDR, HPC_IP_ADDR,
                MIDDLE_TX_PORT_BASE, HPC_RX_PORT_BASE, MIDDLE_OTARESULT_TX_PORT_ID, HPC_OTARESULT_MIDDLE_RX_PORT_ID);
  OtaResultUdpMsg = globalEthPkt;
  
  initUdpPacket(MZCU_MAC_ADDR, HPC_MAC_ADDR, MZCU_IP_ADDR, HPC_IP_ADDR,
                MIDDLE_TX_PORT_BASE, HPC_RX_PORT_BASE, MIDDLE_HEADLAMP_STATUS_TX_PORT_ID, HPC_HEADLAMP_STATUS_RX_PORT_ID);
  HeadLampStatusUdpMsg = globalEthPkt;
  
  initUdpPacket(MZCU_MAC_ADDR, HPC_MAC_ADDR, MZCU_IP_ADDR, HPC_IP_ADDR,
                MIDDLE_TX_PORT_BASE, HPC_RX_PORT_BASE, MIDDLE_CANBUS_ALIVE_TX_PORT_ID, HPC_CANBUS_ALIVE_RX_PORT_ID);
  CanBusAliveUdpMsg = globalEthPkt;
}

on message MBCU_TurnLight_STATUS_100MSG
{
  rxCanLeftFront_Light = this.LeftFront_Light;
  rxCanRightFront_Light = this.RightFront_Light;
}

on message MBCU_BrakeLight_STATUS_100MSG
{
  rxCanBrake_Light = this.Brake_Light;
}

on message MBCU_LowBeam_STATUS_100MSG
{
  rxCanLowBeam_OnOff = this.LowBeam_OnOff;
}

on message MBCU_HighBeam_STATUS_100MSG
{
  rxCanHighBeam_OnOff = this.HighBeam_OnOff;
  rxCanLeft_HighBeam_Status = this.Left_HighBeam_Status;
  rxCanRight_HighBeam_Status = this.Right_HighBeam_Status;
}

on timer loopFlagInit5ms
{
  if(wakeupFlag == 0) return;
  
  HeadLampMiddleFrameReceived10ms = 0;
  OtaMiddleFrameReceived10ms = 0;
  AdbFrameReceived20ms = 0;
  AliveFrontFrameReceived20ms = 0;
  AliveRearFrameReceived20ms = 0;
  TailLampFrameReceived20ms = 0;
  EsaFrameReceived20ms = 0;
  WakeUpReceived = 0;
  RpmInfoFrameReceived20ms = 0;
}

on timer loop20ms
{
  if(wakeupFlag == 0) return;
  
  counter_20ms++;
  
  //Byte[0] : LF Light, RF Light, BrakeLight, LowBeamOnOff, HighBeamOnOff
  //Byte[1] : Left HighBeam Status
  //Byte[2] : Right HighBeam Status
  middleHpcHeadLampStatus20msFrame.LeftFront_RightFront_BrakeLight_LowBeam_HighBeam_Status = 0;
  middleHpcHeadLampStatus20msFrame.LeftFront_RightFront_BrakeLight_LowBeam_HighBeam_Status |= (rxCanLeftFront_Light << 7);
  middleHpcHeadLampStatus20msFrame.LeftFront_RightFront_BrakeLight_LowBeam_HighBeam_Status |= (rxCanRightFront_Light << 6);
  middleHpcHeadLampStatus20msFrame.LeftFront_RightFront_BrakeLight_LowBeam_HighBeam_Status |= (rxCanBrake_Light << 5);
  middleHpcHeadLampStatus20msFrame.LeftFront_RightFront_BrakeLight_LowBeam_HighBeam_Status |= (rxCanLowBeam_OnOff << 4);
  middleHpcHeadLampStatus20msFrame.LeftFront_RightFront_BrakeLight_LowBeam_HighBeam_Status |= (rxCanHighBeam_OnOff << 3);
  middleHpcHeadLampStatus20msFrame.LeftHighBeamStatus = rxCanLeft_HighBeam_Status;
  middleHpcHeadLampStatus20msFrame.RightHighBeamStatus = rxCanRight_HighBeam_Status;
  HeadLampStatusUdpMsg.udp.SetData(0, middleHpcHeadLampStatus20msFrame);
  HeadLampStatusUdpMsg.CompletePacket();
  output(HeadLampStatusUdpMsg);
  write("[Tx] [middle->hpc] headLampStatus sent at %d ms", 20 * counter_20ms);
  
  //MZCU	MBCU	CLU	HU	HVAC
  MiddleCanAliveState = 0;
  MiddleCanAliveState |= (1 << 7);
  MiddleCanAliveState |= rxCanMBCU_Alive ? (1 << 6) : 1;
  MiddleCanAliveState |= rxCanCLU_Alive ? (1 << 5) : 1;
  MiddleCanAliveState |= rxCanHU_Alive ? (1 << 4) : 1;
  MiddleCanAliveState |= rxCanHVAC_Alive ? (1 << 3) : 1;
  middleHpcCanBusAlive20msFrame.FrontZoneCanBus_Alive = FrontCanAliveState; // need to connect
  middleHpcCanBusAlive20msFrame.RearZoneCanBus_Alive = RearCanAliveState; // need to connect
  CanBusAliveUdpMsg.udp.SetData(0, middleHpcCanBusAlive20msFrame);
  CanBusAliveUdpMsg.CompletePacket();
  output(CanBusAliveUdpMsg);
  write("[Tx] [middle->hpc] totalCanAlive sent at %d ms", 20 * counter_20ms);
}

on ethernetPacket *
{
  ip_Endpoint endPointDst;

  this.GetDestinationIPEndpoint(endPointDst);
  
  port_id = (int)(endPointDst.PortNumber - MIDDLE_RX_PORT_BASE);
  allcan_port_id = (int)(endPointDst.PortNumber - ALLCAN_RX_PORT_BASE);
  
  switch(allcan_port_id)
  {
    case ALLCAN_ESA_RX_PORT_ID:
      if(EsaFrameReceived20ms) return;
      EsaFrameReceived20ms = 1;
      this.udp.getData(0, rxEsaFrame);
      write("[RX] [hpc->middle] ESA AlertSpeakerOutput : %d", rxEsaFrame.AlertSpeaker_Output);
      break;
    case ALLCAN_WAKEUP_RX_PORT_ID:
      if(WakeUpReceived) return;
      WakeUpReceived = 1;
      this.udp.getData(0, rxWakeUpFrame);
      wakeupFlag = 1;
      write("[RX] [hpc->middle] Wake up message called");
      break;
    default:
      break;
  }

  switch (port_id)
  {
    case MIDDLE_ADB_RX_PORT_ID:
      if (AdbFrameReceived20ms) break;
      AdbFrameReceived20ms = 1;
      this.udp.GetData(0, rxAdbFrame);
      write("[RX] [hpc->middle] LeftHighBeam : %d, RightHighBeam : %d, LowBeam : %d",
            rxAdbFrame.Left_HighBeam_CTL, rxAdbFrame.Right_HighBeam_CTL,
            rxAdbFrame.LowBeam_CTL);
      //CAN 메세지 MZCU_ADB_Lamp_CTL_MSG 전송
      adb_ctl_msg.LeftHighBeam_CTL = rxAdbFrame.Left_HighBeam_CTL;
      adb_ctl_msg.RightHighBeam_CTL = rxAdbFrame.Right_HighBeam_CTL;
      output(adb_ctl_msg);
      break;
    case MIDDLE_OTAMIDDLE_RX_PORT_ID:
      if (OtaMiddleFrameReceived10ms) break;
      OtaMiddleFrameReceived10ms = 1;
      this.udp.GetData(0, rxOtaMiddleFrame);
      write("[RX] [hpc->middle] OTA MIDDLE GOGO");
      break;
    case MIDDLE_HEADLAMP_MIDDLE_RX_PORT_ID:
      if (HeadLampMiddleFrameReceived10ms) break;
      HeadLampMiddleFrameReceived10ms = 1;
      this.udp.GetData(0, rxHeadLampMiddleFrame);
      //CAN 메세지 MZCU_HLamp_CTL_MSG 전송
      headlamp_msg.HighBeam_Active = rxHeadLampMiddleFrame.HeadLamp_Middle_Status & (1 << 7);
      headlamp_msg.LowBeam_Active  = rxHeadLampMiddleFrame.HeadLamp_Middle_Status & (1 << 6);
      headlamp_msg.LeftTurn_Active = rxHeadLampMiddleFrame.HeadLamp_Middle_Status & (1 << 5);
      headlamp_msg.RightTurn_Active= rxHeadLampMiddleFrame.HeadLamp_Middle_Status & (1 << 4);
      output(headlamp_msg);
      write("[RX] [front->middle] HeadLamp status : %d", rxHeadLampMiddleFrame.HeadLamp_Middle_Status);
      break;
    case MIDDLE_ALIVE_FRONT_RX_PORT_ID:
      if (AliveFrontFrameReceived20ms) break;
      AliveFrontFrameReceived20ms = 1;
      this.udp.GetData(0, rxFrontAliveFrame);
      FrontCanAliveState = rxFrontAliveFrame.ECU_Alive_Status;
      write("[RX] [front->middle] Front Alive : %d", rxFrontAliveFrame.ECU_Alive_Status);
      break;
    case MIDDLE_ALIVE_REAR_RX_PORT_ID:
      if (AliveRearFrameReceived20ms) break;
      AliveRearFrameReceived20ms = 1;
      this.udp.GetData(0, rxRearAliveFrame);
      RearCanAliveState = rxRearAliveFrame.ECU_Alive_Status;
      write("[RX] [rear->middle] Rear Alive : %d", rxRearAliveFrame.ECU_Alive_Status);
      break;
    case MIDDLE_TAILLAMP_RX_PORT_ID:
      if (TailLampFrameReceived20ms) break;
      TailLampFrameReceived20ms = 1;
      this.udp.GetData(0, rxTailLampStatusFrame);
      write("[RX] [rear->middle] BrakeLight : %d, LeftRearTurn: %d, RightRearTurn : %d",
            rxTailLampStatusFrame.Brake_Light_Status,
            rxTailLampStatusFrame.LeftRear_TurnSignal_Status,
            rxTailLampStatusFrame.RightRear_TurnSignal_Status);
      break;
    case MIDDLE_RPMINFO_RX_PORT_ID:
      if (RpmInfoFrameReceived20ms) break;
      RpmInfoFrameReceived20ms = 1;
      this.udp.GetData(0, rxRpmInfoFrame);
      write("[RX] [hpc->middle] LeftRPM : %d, RightRPM : %d", rxRpmInfoFrame.LeftRear_MotorRPM, rxRpmInfoFrame.RightRear_MotorRPM);
      motor_ctl_msg.Left_Motor_RPM = rxRpmInfoFrame.LeftRear_MotorRPM;
      output(motor_ctl_msg);
      break;
    default:
      break;
  }
}

void initUdpPacket(char TX_MAC_ADDR[], char RX_MAC_ADDR[],
                  char TX_IP_ADDR[], char RX_IP_ADDR[],
                  long TX_PORT_BASE, long RX_PORT_BASE,
                  long TX_PORT_ID, long RX_PORT_ID)
{
  globalEthPkt.source = ethGetMacAddressAsNumber(TX_MAC_ADDR);
  globalEthPkt.destination = ethGetMacAddressAsNumber(RX_MAC_ADDR);
  globalEthPkt.udp.init();
  globalEthPkt.type = 0x0800;
  globalEthPkt.Length = 104;
  globalEthPkt.udp.length = 64;
  globalEthPkt.ipv4.source.ParseAddress(TX_IP_ADDR);
  globalEthPkt.ipv4.destination.ParseAddress(RX_IP_ADDR);
  globalEthPkt.udp.source = TX_PORT_BASE + TX_PORT_ID;
  globalEthPkt.udp.destination = RX_PORT_BASE + RX_PORT_ID;

  /*
  이후 해야할 일
  struct myFrame 초기화
  ethpkt->setData(0, myFrame);
  ethpkt->Length = (length); (OTA는 길게 해야함)
  ethpkt->CompletePacket();
  output(*ethpkt)
  */
}

on message MBCU_Alive_INFO_20MSG
{
}

on message MBCU_OTAResult_STATUS_MSG
{
}

on message CLU_Alive_INFO_20MSG
{
}

on message CLU_OTAResult_STATUS_MSG
{
}

on message HU_SoundAlertOnOff_CTL_MSG
{
  soundFlag = this.SoundAlertOnOff_Signal;
}

on message HU_ObsDetectDist_INFO_MSG
{
  OBDistance = this.ObstacleDetectDistance_Signal;
}

// OTA 업데이트 승인 여부 CAN 메세지 수신
on message HU_UpdateAcceptDecline_CTL_MSG
{
  middleHpcOtaAssignRejectFrame.UpdateAcceptDecline_Signal = this.UpdateAcceptDecline_Signal;
  OtaAssignRejectUdpMsg.udp.SetData(0, middleHpcOtaAssignRejectFrame);
  OtaAssignRejectUdpMsg.CompletePacket();
  output(OtaAssignRejectUdpMsg);
}

on message HU_Alive_INFO_20MSG
{
}

on message HU_OTAResult_STATUS_MSG
{  
}
