/*@!Encoding:65001*/
includes
{
  #include "../includes/eth_frame.can"
}

variables
{
  msTimer loop20ms;
  msTimer loopFlagInit5ms;
  
  int counter_20ms;
  
  byte wakeupFlag; // 0 : sleep 1 : wakeup
  byte soundFlag;  // 0 : off   1 : on
  
  byte hlampFlag;
  byte adbFlag;
  byte otaFlag;
  byte updateFlag;
  byte steeringFlag;
  byte speakerFlag;
  byte otaAlarmFlag;
  byte motorFlag;
  byte otaAssignFlag;
  byte adasFlag;
  byte transmissionFlag;
  byte ObstacleDistanceFlag;
  byte EmergencyFlag;
  
  int OBDistance;
  byte Emergency;
  int port_id;
  int allcan_port_id;
  
  ethernetPacket globalEthPkt;
  
  ethernetPacket OtaAssignRejectUdpMsg;
  ethernetPacket OtaResultUdpMsg;
  ethernetPacket HeadLampStatusUdpMsg;
  ethernetPacket CanBusAliveUdpMsg;
  ethernetPacket ObstacleDetectDistMsg;
  ethernetPacket MiddleRearEmergencyOnOffMsg;
  
  //CAN MSG
  message MZCU_HLamp_CTL_MSG headlamp_msg;
  message MZCU_ADB_Lamp_CTL_MSG adb_ctl_msg;
  message MZCU_MotorRPM_INFO_20MSG motor_ctl_msg; // 수정 motor_ctl_msg.Left_Motor_RPM -> motor_ctl_msg.VCU_Calculate_RPM
  message MZCU_OTA_MBCU_MSG ota_mbcu_msg;
  message MZCU_OTA_HU_MSG ota_hu_msg;
  message MZCU_OTA_HVAC_MSG ota_hvac_msg;
  message MZCU_OTA_CLU_MSG ota_clu_msg;
  message MZCU_WakeUp_CTL_MSG wakeup_ctl_msg;
  
  message MZCU_UpdateAlarm_INFO_MSG update_msg;
  message MZCU_ADAS_Status_20MSG adas_msg;
  message MZCU_Transmission_STATUS_20MSG trans_msg;
  message MZCU_Battery_STATUS_100MSG battery_msg;
  message MZCU_DoorOpenClose_CTL_MSG door_msg;
  message MZCU_SteeringAngle_CTL_20MSG steering_ctl_msg;
  message MZCU_AlertSpeaker_CTL_MSG alert_msg;
  
  // TX FRAME
  struct MiddleHpcOtaAssignRejectFrame middleHpcOtaAssignRejectFrame;
  struct MiddleHpcOtaResultFrame middleHpcOtaResultFrame;
  struct MiddleHpcHeadLampStatusFrame middleHpcHeadLampStatus20msFrame;
  struct MiddleHpcCanBusAliveFrame middleHpcCanBusAlive20msFrame;
  struct MiddleHpcObstacleDetectDistFrame middleHpcObstacleDetectDistFrame;
  struct MiddleRearEmergencyOnOffFrame middleRearEmergencyOnOffFrame;
  
  // RX FRAME
  struct HpcMiddleAdbFrame rxAdbFrame;
  struct HpcMiddleOtaMiddleFrame rxOtaMiddleFrame;
  struct FrontMiddleHeadLampMiddleFrame rxHeadLampMiddleFrame;
  struct FrontMiddleAliveFrame rxFrontAliveFrame;
  struct RearMiddleAliveFrame rxRearAliveFrame;
  struct RearMiddleTailLampStatusFrame rxTailLampStatusFrame;
  struct HpcMiddleRpmInfoFrame rxRpmInfoFrame;
  struct HpcMiddleOtaAlarmFrame rxOtaAlarmFrame;
  struct HpcMiddleAdasStateFrame rxAdasStateFrame;
  struct HpcMiddleTransmissionStateFrame rxTransmissionStateFrame;
  
  // RX FRAME(ALL)
  struct HpcAllEsaFrame rxEsaFrame;
  struct HpcAllWakeUpFrame rxWakeUpFrame;
  
  byte AdbFrameReceived20ms;
  byte OtaMiddleFrameReceived10ms;
  byte HeadLampMiddleFrameReceived10ms;
  byte AliveFrontFrameReceived20ms;
  byte AliveRearFrameReceived20ms;
  byte TailLampFrameReceived20ms;
  byte RpmInfoFrameReceived20ms;
  byte OtaAlarmFrameFecieved20ms;
  byte AdasStateFrameFecieved20ms;
  byte TransmissionFrameFecieved20ms;
  
  byte EsaFrameReceived20ms;
  byte WakeUpReceived;
  
  //===============MIDDLE ZCU VARIABLES====================//
  byte FrontCanAliveState;
  byte MiddleCanAliveState;
  byte RearCanAliveState;
  
  byte rxCanHVAC_Alive;
  byte rxCanHU_Alive;
  byte rxCanCLU_Alive;
  byte rxCanMBCU_Alive;
  
  byte rxCanHVAC_OTA;
  byte rxCanHU_OTA;
  byte rxCanCLU_OTA;
  byte rxCanMBCU_OTA;
  
  // MBCU RX can message
    // MBCU_TurnLight_STATUS_100MSG
  byte rxCanLeftFront_Light;
  byte rxCanRightFront_Light;
    // MBCU_BrakeLight_STATUS_100MSG
  byte rxCanBrake_Light;
    // MBCU_LowBeam_STATUS_100MSG
  byte rxCanLowBeam_OnOff;
    // MBCU_HighBeam_STATUS_100MSG 
  byte rxCanHighBeam_OnOff;
  byte rxCanLeft_HighBeam_Status;
  byte rxCanRight_HighBeam_Status;
  
  byte rxSteeringAngle;
  byte rxSpeaker;
  byte rxAdbLeft;
  byte rxAdbRight;
  byte rxFrontUpdateID;
  byte rxMiddleUpdateID;
  byte rxRearUpdateID;
  byte rxOtaAlarmID;
  byte rxOtaAssign;
  byte rxGear_Position;
  byte rxLKAS_On_Off;
  byte rxESA_On_Off;
  byte rxADB_On_Off;
  
  byte txOtaResultID;

  int i, j;
  qword ota_value;
  byte prev_gear_position;
}

on start 
{
  counter_20ms = 0;
  wakeupFlag = 0;
  soundFlag = 0;
  OBDistance = 255;
  
  hlampFlag = 0;
  adbFlag = 0;
  otaFlag = 0;
  updateFlag = 0;
  steeringFlag = 0;
  speakerFlag = 0;
  otaAlarmFlag = 0;
  motorFlag = 0;
  otaAssignFlag = 0;
  adasFlag = 0;
  transmissionFlag = 0;
  ObstacleDistanceFlag = 0;
  
  AdbFrameReceived20ms = 0;
  OtaMiddleFrameReceived10ms = 0;
  HeadLampMiddleFrameReceived10ms = 0;
  AliveFrontFrameReceived20ms = 0;
  AliveRearFrameReceived20ms = 0;
  TailLampFrameReceived20ms = 0;
  EsaFrameReceived20ms = 0;
  OtaAlarmFrameFecieved20ms = 0;
  AdasStateFrameFecieved20ms = 0;
  TransmissionFrameFecieved20ms = 0;
  
  WakeUpReceived = 0;
  RpmInfoFrameReceived20ms = 0;
  otaAlarmFlag = 0;
  
  rxFrontUpdateID = 0;
  rxMiddleUpdateID = 0;
  rxRearUpdateID = 0;
  rxOtaAlarmID = 0;
  txOtaResultID = 0;
  rxOtaAssign = 0;

  setTimerCyclic(loopFlagInit5ms, 5);
  setTimerCyclic(loop20ms, 20);
  
  initUdpPacket(MZCU_MAC_ADDR, HPC_MAC_ADDR, MZCU_IP_ADDR, HPC_IP_ADDR,
                MIDDLE_TX_PORT_BASE, HPC_RX_PORT_BASE, 
                MIDDLE_OTA_ASSIGN_REJECT_TX_PORT_ID, HPC_OTA_ASSIGN_REJECT_RX_PORT_ID);
  OtaAssignRejectUdpMsg = globalEthPkt;
  
  initUdpPacket(MZCU_MAC_ADDR, HPC_MAC_ADDR, MZCU_IP_ADDR, HPC_IP_ADDR,
                MIDDLE_TX_PORT_BASE, HPC_RX_PORT_BASE, MIDDLE_OTARESULT_TX_PORT_ID, HPC_OTARESULT_MIDDLE_RX_PORT_ID);
  OtaResultUdpMsg = globalEthPkt;
  
  initUdpPacket(MZCU_MAC_ADDR, HPC_MAC_ADDR, MZCU_IP_ADDR, HPC_IP_ADDR,
                MIDDLE_TX_PORT_BASE, HPC_RX_PORT_BASE, MIDDLE_HEADLAMP_STATUS_TX_PORT_ID, HPC_HEADLAMP_STATUS_RX_PORT_ID);
  HeadLampStatusUdpMsg = globalEthPkt;
  
  initUdpPacket(MZCU_MAC_ADDR, HPC_MAC_ADDR, MZCU_IP_ADDR, HPC_IP_ADDR,
                MIDDLE_TX_PORT_BASE, HPC_RX_PORT_BASE, MIDDLE_CANBUS_ALIVE_TX_PORT_ID, HPC_CANBUS_ALIVE_RX_PORT_ID);
  CanBusAliveUdpMsg = globalEthPkt;
  
  initUdpPacket(MZCU_MAC_ADDR, HPC_MAC_ADDR, MZCU_IP_ADDR, HPC_IP_ADDR,
                MIDDLE_TX_PORT_BASE, HPC_RX_PORT_BASE, MIDDLE_OBSTACLE_DETECT_DIST_TX_PORT_ID, HPC_OBSTACLE_DETECT_DIST_TX_PORT_ID);
  ObstacleDetectDistMsg = globalEthPkt;
  
  initUdpPacket(MZCU_MAC_ADDR, RZCU_MAC_ADDR, MZCU_IP_ADDR, RZCU_IP_ADDR,
                MIDDLE_TX_PORT_BASE, REAR_RX_PORT_BASE, MIDDLE_EMERGENCY_ON_OFF_TX_PORT_ID, REAR_EMERGENCY_RX_PORT_ID);
  MiddleRearEmergencyOnOffMsg = globalEthPkt;
}

on message MBCU_TurnLight_STATUS_100MSG
{
  rxCanLeftFront_Light = this.LeftFront_Light;
  rxCanRightFront_Light = this.RightFront_Light;
}

on message MBCU_BrakeLight_STATUS_100MSG
{
  rxCanBrake_Light = this.Brake_Light;
}

on message MBCU_LowBeam_STATUS_100MSG
{
  rxCanLowBeam_OnOff = this.LowBeam_OnOff;
}

on message MBCU_HighBeam_STATUS_100MSG
{
  rxCanHighBeam_OnOff = this.HighBeam_OnOff;
  rxCanLeft_HighBeam_Status = this.Left_HighBeam_Status;
  rxCanRight_HighBeam_Status = this.Right_HighBeam_Status;
}

on timer loopFlagInit5ms
{
  if(wakeupFlag == 0) return;
  
  HeadLampMiddleFrameReceived10ms = 0;
  OtaMiddleFrameReceived10ms = 0;
  AdbFrameReceived20ms = 0;
  AliveFrontFrameReceived20ms = 0;
  AliveRearFrameReceived20ms = 0;
  TailLampFrameReceived20ms = 0;
  EsaFrameReceived20ms = 0;
  WakeUpReceived = 0;
  RpmInfoFrameReceived20ms = 0;
  OtaAlarmFrameFecieved20ms = 0;
  AdasStateFrameFecieved20ms = 0;
  TransmissionFrameFecieved20ms = 0;
}

on timer loop20ms
{
  if(wakeupFlag == 0) return;

  counter_20ms++;
  
  //ethernetPacket HeadLampStatusUdpMsg;
  //Byte[0] : LF Light, RF Light, BrakeLight, LowBeamOnOff, HighBeamOnOff
  //Byte[1] : Left HighBeam Status
  //Byte[2] : Right HighBeam Status
  middleHpcHeadLampStatus20msFrame.LeftFront_RightFront_BrakeLight_LowBeam_HighBeam_Status = 0;
  middleHpcHeadLampStatus20msFrame.LeftFront_RightFront_BrakeLight_LowBeam_HighBeam_Status |= (rxCanLeftFront_Light << 7);
  middleHpcHeadLampStatus20msFrame.LeftFront_RightFront_BrakeLight_LowBeam_HighBeam_Status |= (rxCanRightFront_Light << 6);
  middleHpcHeadLampStatus20msFrame.LeftFront_RightFront_BrakeLight_LowBeam_HighBeam_Status |= (rxCanBrake_Light << 5);
  middleHpcHeadLampStatus20msFrame.LeftFront_RightFront_BrakeLight_LowBeam_HighBeam_Status |= (rxCanLowBeam_OnOff << 4);
  middleHpcHeadLampStatus20msFrame.LeftFront_RightFront_BrakeLight_LowBeam_HighBeam_Status |= (rxCanHighBeam_OnOff << 3);
  middleHpcHeadLampStatus20msFrame.LeftHighBeamStatus = rxCanLeft_HighBeam_Status;
  middleHpcHeadLampStatus20msFrame.RightHighBeamStatus = rxCanRight_HighBeam_Status;
  HeadLampStatusUdpMsg.udp.SetData(0, middleHpcHeadLampStatus20msFrame);
  HeadLampStatusUdpMsg.CompletePacket();
  output(HeadLampStatusUdpMsg);
  write("[Tx] [middle->hpc] headLampStatus sent at %d ms", 20 * counter_20ms);
  
  //ethernetPacket CanBusAliveUdpMsg;
  //MZCU	MBCU	CLU	HU	HVAC
  MiddleCanAliveState = 0;
  MiddleCanAliveState |= (1 << 7);
  MiddleCanAliveState |= rxCanMBCU_Alive << 6;
  MiddleCanAliveState |= rxCanCLU_Alive << 5;
  MiddleCanAliveState |= rxCanHU_Alive << 4;
  MiddleCanAliveState |= rxCanHVAC_Alive << 3;
  middleHpcCanBusAlive20msFrame.FrontZoneCanBus_Alive = FrontCanAliveState; // need to connect
  middleHpcCanBusAlive20msFrame.RearZoneCanBus_Alive = RearCanAliveState; // need to connect
  middleHpcCanBusAlive20msFrame.MiddleZoneCanBus_Alive = MiddleCanAliveState;
  CanBusAliveUdpMsg.udp.SetData(0, middleHpcCanBusAlive20msFrame);
  CanBusAliveUdpMsg.CompletePacket();
  output(CanBusAliveUdpMsg);
  write("[Tx] [middle->hpc] totalCanAlive sent at %d ms", 20 * counter_20ms);
  
  if(ObstacleDistanceFlag){
    middleHpcObstacleDetectDistFrame.ObstacleDetectDistance = OBDistance;
    ObstacleDetectDistMsg.udp.SetData(0, middleHpcObstacleDetectDistFrame);
    ObstacleDetectDistMsg.CompletePacket();
    output(ObstacleDetectDistMsg);
    write("[Tx] [middle->hpc] ObstacleDetectDistMsg - [%d]", middleHpcObstacleDetectDistFrame.ObstacleDetectDistance);
    ObstacleDistanceFlag=0;
  }
  
  if(EmergencyFlag){
    middleRearEmergencyOnOffFrame.Emergency_Light = Emergency;
    MiddleRearEmergencyOnOffMsg.udp.SetData(0, middleRearEmergencyOnOffFrame);
    MiddleRearEmergencyOnOffMsg.CompletePacket();
    output(MiddleRearEmergencyOnOffMsg);
    write("[Tx] [middle->Rear] middleRearEmergencyOnOffFrame - [%d]", middleRearEmergencyOnOffFrame.Emergency_Light);
    EmergencyFlag=0;
  } // Ok
  
  //ethernetPacket OtaResultUdpMsg;
  if(otaFlag){
    txOtaResultID = 0;  // MZCU MBCU CLU HU HVAC
    txOtaResultID |= rxCanMBCU_OTA << 6;
    txOtaResultID |= rxCanCLU_OTA << 5;
    txOtaResultID |= rxCanHU_OTA << 4;
    txOtaResultID |= rxCanHVAC_OTA << 3;    
    middleHpcOtaResultFrame.ECU_OTA_Result = txOtaResultID;
    OtaResultUdpMsg.udp.SetData(0, middleHpcOtaResultFrame);
    OtaResultUdpMsg.CompletePacket();
    output(OtaResultUdpMsg);
    write("[Tx] [middle->hpc] OtaResultUdpMsg");
    rxCanMBCU_OTA = 0;
    rxCanCLU_OTA  = 0;
    rxCanHU_OTA = 0;
    rxCanHVAC_OTA = 0; 
    otaFlag = 0;
  }
  
  //ethernetPacket OtaAssignRejectUdpMsg;
  if(otaAssignFlag){
    middleHpcOtaAssignRejectFrame.UpdateAcceptDecline_Signal = rxOtaAssign;
    OtaAssignRejectUdpMsg.udp.SetData(0, middleHpcOtaAssignRejectFrame);
    OtaAssignRejectUdpMsg.CompletePacket();
    output(OtaAssignRejectUdpMsg);
    write("[Tx] [middle->hpc] OtaAssignRejectUdpMsg");
    rxOtaAssign = 0;
    otaAssignFlag = 0;
  }
    
  
  //----------------------------CAN TX MSG--------------------------------
  // MZCU_WakeUp_CTL_MSG wakeup_ctl_msg : ALLCAN_WAKEUP_RX_PORT_ID
  // MZCU_DoorOpenClose_CTL_MSG door_msg : X
  // MZCU_Battery_STATUS_100MSG battery_msg : X
  // MZCU_OTA_MBCU_MSG ota_mbcu_msg : OTA CAN 메세지 -> Eth RX port 에 작성
  // MZCU_OTA_HU_MSG ota_hu_msg 
  // MZCU_OTA_HVAC_MSG ota_hvac_msg
  // MZCU_OTA_CLU_MSG ota_clu_msg
  
  // MZCU_HLamp_CTL_MSG headlamp_msg : 
  if(hlampFlag){
    headlamp_msg.HighBeam_Active = (rxHeadLampMiddleFrame.HeadLamp_Middle_Status & (1 << 7)) >> 7;
    headlamp_msg.LowBeam_Active  = (rxHeadLampMiddleFrame.HeadLamp_Middle_Status & (1 << 6)) >> 6;
    headlamp_msg.LeftTurn_Active = (rxHeadLampMiddleFrame.HeadLamp_Middle_Status & (1 << 5)) >> 5;
    headlamp_msg.RightTurn_Active= (rxHeadLampMiddleFrame.HeadLamp_Middle_Status & (1 << 4)) >> 4;
    output(headlamp_msg);
    write("MZCU : [CAN] MZCU_HLamp_CTL_MSG %d, %d",rxHeadLampMiddleFrame.HeadLamp_Middle_Status, headlamp_msg.HighBeam_Active);
    hlampFlag = 0;
  }
  // MZCU_ADB_Lamp_CTL_MSG adb_ctl_msg;
  if(adbFlag){
    adb_ctl_msg.LeftHighBeam_CTL = rxAdbLeft;
    adb_ctl_msg.RightHighBeam_CTL = rxAdbRight;
    output(adb_ctl_msg);
    write("MZCU : [CAN] MZCU_ADB_Lamp_CTL_MSG");
    adbFlag = 0;
  }
  // MZCU_MotorRPM_INFO_20MSG motor_ctl_msg;
  if(motorFlag){
    motor_ctl_msg.RPM = rxRpmInfoFrame.VCU_RPM;
    motor_ctl_msg.Velocity = rxRpmInfoFrame.MCU_Velocity;
    output(motor_ctl_msg);
    write("MZCU : [CAN] MZCU_MotorRPM_INFO_20MSG RPM = %d, Velocity = %d", motor_ctl_msg.RPM, motor_ctl_msg.Velocity);
    motorFlag = 0;
  }
  
  
  
  // MZCU_SteeringAngle_CTL_20MSG steering_ctl_msg : ALLCAN_ESA_RX_PORT_ID
  if(steeringFlag){
    steering_ctl_msg.SteeringAngle_CTL = rxSteeringAngle;
    output(steering_ctl_msg);
    write("MZCU : [CAN] MZCU_SteeringAngle_CTL_20MSG");
    steeringFlag = 0;
  }
  // MZCU_AlertSpeaker_CTL_MSG alert_msg : ALLCAN_ESA_RX_PORT_ID
  if(speakerFlag){
    alert_msg.AlertSpeaker = rxSpeaker;
    output(alert_msg);
    write("MZCU : [CAN] MZCU_AlertSpeaker_CTL_MSG");
    speakerFlag = 0;
  }
  
  // MZCU_UpdateAlarm_INFO_MSG update_msg;
  if(otaAlarmFlag){
    switch(rxOtaAlarmFrame.FrontZone_ECU_ID){ 
      // FZCU VCU ABS MDPS MFS
      // 0~4 : FZCU VCU ABS MDPS MFS
      case 1 << 7:
        rxOtaAlarmID = 0;
        break;
      case 1 << 6:
        rxOtaAlarmID = 1;
        break;
      case 1 << 5:
        rxOtaAlarmID = 2;
        break;
      case 1 << 4:
        rxOtaAlarmID = 3;
        break;
      case 1 << 3:
        rxOtaAlarmID = 4;
        break;
      default:
        break;
    }
    switch(rxOtaAlarmFrame.MiddleZone_ECU_ID){ 
      // MZCU MBCU CLU HU HVAC
      // 5~9 : MZCU MBCU CLU HU HVAC
      case 1 << 7:
        rxOtaAlarmID = 5;
        break;
      case 1 << 6:
        rxOtaAlarmID = 6;
        break;
      case 1 << 5:
        rxOtaAlarmID = 7;
        break;
      case 1 << 4:
        rxOtaAlarmID = 8;
        break;
      case 1 << 3:
        rxOtaAlarmID = 9;
        break;
      default:
        break;
    }
    switch(rxOtaAlarmFrame.RearZone_ECU_ID){ 
      // RZCU RBCU USS MCU
      // 10~13 : RZCU RBCU USS MCU
      case 1 << 7:
        rxOtaAlarmID = 10;
        break;
      case 1 << 6:
        rxOtaAlarmID = 11;
        break;
      case 1 << 5:
        rxOtaAlarmID = 12;
        break;
      case 1 << 4:
        rxOtaAlarmID = 13;
        break;
      default:
        break;
    }
    update_msg.Update_ID = rxOtaAlarmID;
    output(update_msg);
    write("MZCU : [CAN] MZCU_AlertSpeaker_CTL_MSG");
    otaAlarmFlag = 0;
  }
  
  // MZCU_ADAS_Status_20MSG adas_msg;
  if(adasFlag){
    adas_msg.LKAS_Active = rxLKAS_On_Off;
    adas_msg.ESA_Active = rxESA_On_Off;
    adas_msg.ADB_Active = rxADB_On_Off;
    output(adas_msg);
    write("MZCU : [CAN] MZCU_ADAS_Status_20MSG");
    adasFlag = 0;
  }
  // MZCU_Transmission_STATUS_20MSG trans_msg;
  if(transmissionFlag){
    trans_msg.Transmission_Status = rxGear_Position;
    output(trans_msg);
    write("MZCU : [CAN] MZCU_Transmission_STATUS_20MSG, %d", rxGear_Position);
    transmissionFlag = 0;
  }
  
}

on ethernetPacket *
{
  ip_Endpoint endPointDst;

  this.GetDestinationIPEndpoint(endPointDst);
  
  port_id = (int)(endPointDst.PortNumber - MIDDLE_RX_PORT_BASE);
  allcan_port_id = (int)(endPointDst.PortNumber - ALLCAN_RX_PORT_BASE);
  
  switch(allcan_port_id)
  {
    case ALLCAN_ESA_RX_PORT_ID: // MZCU_SteeringAngle_CTL_20MSG
      if(EsaFrameReceived20ms) return;
      EsaFrameReceived20ms = 1;
      this.udp.getData(0, rxEsaFrame);
      rxSteeringAngle = rxEsaFrame.ESA_Steering_Angle;
      rxSpeaker = rxEsaFrame.AlertSpeaker_Output;
      write("[RX] [hpc->middle] ESA AlertSpeakerOutput : %d", rxEsaFrame.AlertSpeaker_Output);
      steeringFlag = 1;
      speakerFlag = 1;
      break;
    case ALLCAN_WAKEUP_RX_PORT_ID: // MZCU_WakeUp_CTL_MSG
      if(WakeUpReceived) return;
      WakeUpReceived = 1;
      this.udp.getData(0, rxWakeUpFrame);
      wakeupFlag = 1;
      write("[RX] [hpc->middle] Wake up message called");
      
      wakeup_ctl_msg.WakeUpSignal = rxWakeUpFrame.WakeUp_ALL_ECU;
      output(wakeup_ctl_msg);
      write("MZCU : [CAN] MZCU_WakeUp_CTL_MSG");
      break;
    default:
      break;
  }

  switch (port_id)
  {
    case MIDDLE_ADB_RX_PORT_ID: // MZCU_ADB_Lamp_CTL_MSG
      if (AdbFrameReceived20ms) break;
      AdbFrameReceived20ms = 1;
      this.udp.GetData(0, rxAdbFrame);
      rxAdbLeft = rxAdbFrame.Left_HighBeam_CTL;
      rxAdbRight= rxAdbFrame.Right_HighBeam_CTL;
      write("[RX] [hpc->middle] LeftHighBeam : %d, RightHighBeam : %d, LowBeam : %d",
            rxAdbFrame.Left_HighBeam_CTL, rxAdbFrame.Right_HighBeam_CTL,
            rxAdbFrame.LowBeam_CTL);
      adbFlag = 1;
      break;
    case MIDDLE_OTAMIDDLE_RX_PORT_ID:
      if (OtaMiddleFrameReceived10ms) break;
      OtaMiddleFrameReceived10ms = 1;
      this.udp.GetData(0, rxOtaMiddleFrame);
      write("[RX] [hpc->middle] OTA MIDDLE GOGO");
      for (i = 0; i < rxOtaMiddleFrame.Total_Byte; i += 8)
      {
        ota_value = 0;
        for (j = 0; j < 8; j++)
        {
          if (rxOtaMiddleFrame.Total_Byte - i < j) break;
          ota_value |= rxOtaMiddleFrame.Data[i+j];
          if (j != 7) ota_value = (ota_value << 8); // Endian 계산 정확한지 모르겠음.
        }
            
        // MZCU MBCU CLU HU HVAC
        switch(rxOtaMiddleFrame.ECU_Select)
        {
          case (1 << 7): // MZCU
            break;
          case (1 << 6): // MBCU
            ota_mbcu_msg.MBCU_OTA = ota_value;
            output(ota_mbcu_msg);
            break;
          case (1 << 5): // CLU
            ota_clu_msg.CLU_OTA = ota_value;
            output(ota_clu_msg);
            break;
          case (1 << 4): // HU
            ota_hu_msg.HU_OTA = ota_value;
            output(ota_hu_msg);
            break;
          case (1 << 3): // HVAC
            ota_hvac_msg.HVAC_OTA = ota_value;
            output(ota_hvac_msg);
            break;
          default:
            break;
        }
      }
      break;
    case MIDDLE_HEADLAMP_MIDDLE_RX_PORT_ID:
      if (HeadLampMiddleFrameReceived10ms) break;
      HeadLampMiddleFrameReceived10ms = 1;
      this.udp.GetData(0, rxHeadLampMiddleFrame);
      write("[RX] [front->middle] HeadLamp status : %d", rxHeadLampMiddleFrame.HeadLamp_Middle_Status);
      hlampFlag = 1;
      break;
    case MIDDLE_ALIVE_FRONT_RX_PORT_ID:
      if (AliveFrontFrameReceived20ms) break;
      AliveFrontFrameReceived20ms = 1;
      this.udp.GetData(0, rxFrontAliveFrame);
      FrontCanAliveState = rxFrontAliveFrame.ECU_Alive_Status;
      write("[RX] [front->middle] Front Alive : %d", rxFrontAliveFrame.ECU_Alive_Status);
      break;
    case MIDDLE_ALIVE_REAR_RX_PORT_ID:
      if (AliveRearFrameReceived20ms) break;
      AliveRearFrameReceived20ms = 1;
      this.udp.GetData(0, rxRearAliveFrame);
      RearCanAliveState = rxRearAliveFrame.ECU_Alive_Status;
      write("[RX] [rear->middle] Rear Alive : %d", rxRearAliveFrame.ECU_Alive_Status);
      break;
    case MIDDLE_TAILLAMP_RX_PORT_ID:
      if (TailLampFrameReceived20ms) break;
      TailLampFrameReceived20ms = 1;
      this.udp.GetData(0, rxTailLampStatusFrame);
      write("[RX] [rear->middle] BrakeLight : %d, LeftRearTurn: %d, RightRearTurn : %d",
            rxTailLampStatusFrame.Brake_Light_Status,
            rxTailLampStatusFrame.LeftRear_TurnSignal_Status,
            rxTailLampStatusFrame.RightRear_TurnSignal_Status);
      break;
    case MIDDLE_RPMINFO_RX_PORT_ID:
      if (RpmInfoFrameReceived20ms) break;
      RpmInfoFrameReceived20ms = 1;
      this.udp.GetData(0, rxRpmInfoFrame);
      write("[RX] [hpc->middle] Velocity : %d", rxRpmInfoFrame.VCU_RPM);
      motorFlag = 1;
      break;
    case MIDDLE_OTA_ALARM_RX_PORT_ID:
      if(OtaAlarmFrameFecieved20ms) break;
      OtaAlarmFrameFecieved20ms = 1;
      this.udp.GetData(0, rxOtaAlarmFrame);
      write("[RX] [hpc->middle] FrontZone_ECU_ID : %d, MiddleZone_ECU_ID : %d, RearZone_ECU_ID : %d", 
              rxOtaAlarmFrame.FrontZone_ECU_ID, 
              rxOtaAlarmFrame.MiddleZone_ECU_ID,
              rxOtaAlarmFrame.RearZone_ECU_ID);
      otaAlarmFlag = 1;
      break;
    case MIDDLE_ADAS_STATE_RX_PORT_ID:
      if(AdasStateFrameFecieved20ms) break;
      AdasStateFrameFecieved20ms = 1;
      this.udp.GetData(0, rxAdasStateFrame);
      rxLKAS_On_Off = rxAdasStateFrame.LKAS_On_Off;
      rxESA_On_Off = rxAdasStateFrame.ESA_On_Off;
      rxADB_On_Off = rxAdasStateFrame.ADB_On_Off;
      write("[RX] [hpc->middle] ADB_On_Off : %d, ESA_On_Off : %d, LKAS_On_Off : %d", 
              rxAdasStateFrame.ADB_On_Off, 
              rxAdasStateFrame.ESA_On_Off,
              rxAdasStateFrame.LKAS_On_Off);
      adasFlag = 1;
      break;
    case MIDDLE_TRANSMISSION_STATE_RX_PORT_ID:
      if(TransmissionFrameFecieved20ms) break;
      TransmissionFrameFecieved20ms = 1;
      this.udp.GetData(0, rxTransmissionStateFrame);
      rxGear_Position = rxTransmissionStateFrame.Gear_Position;
      write("[RX] [hpc->middle] Gear_Position : %d", rxTransmissionStateFrame.Gear_Position);
      transmissionFlag = 1;
      break;
    default:
      break;
  }
}

void initUdpPacket(char TX_MAC_ADDR[], char RX_MAC_ADDR[],
                  char TX_IP_ADDR[], char RX_IP_ADDR[],
                  long TX_PORT_BASE, long RX_PORT_BASE,
                  long TX_PORT_ID, long RX_PORT_ID)
{
  globalEthPkt.source = ethGetMacAddressAsNumber(TX_MAC_ADDR);
  globalEthPkt.destination = ethGetMacAddressAsNumber(RX_MAC_ADDR);
  globalEthPkt.udp.init();
  globalEthPkt.type = 0x0800;
  globalEthPkt.Length = 104;
  globalEthPkt.udp.length = 64;
  globalEthPkt.ipv4.source.ParseAddress(TX_IP_ADDR);
  globalEthPkt.ipv4.destination.ParseAddress(RX_IP_ADDR);
  globalEthPkt.udp.source = TX_PORT_BASE + TX_PORT_ID;
  globalEthPkt.udp.destination = RX_PORT_BASE + RX_PORT_ID;

  /*
  이후 해야할 일
  struct myFrame 초기화
  ethpkt->setData(0, myFrame);
  ethpkt->Length = (length); (OTA는 길게 해야함)
  ethpkt->CompletePacket();
  output(*ethpkt)
  */
}

on message MBCU_Alive_INFO_20MSG
{
  rxCanMBCU_Alive = this.MBCU_Alive;
}

on message MBCU_OTAResult_STATUS_MSG
{
  rxCanMBCU_OTA = this.MBCU_OTAResult;
  otaFlag = 1;
}

on message CLU_Alive_INFO_20MSG
{
  rxCanCLU_Alive = this.CLU_Alive;
}

on message CLU_OTAResult_STATUS_MSG
{
  rxCanCLU_OTA = this.CLU_OTAResult;
  otaFlag = 1;
}

on message HU_SoundAlertOnOff_CTL_MSG
{
  soundFlag = this.SoundAlertOnOff_Signal;
}

on message HU_ObsDetectDist_INFO_MSG
{
  OBDistance = this.ObstacleDetectDistance_Signal;
  ObstacleDistanceFlag = 1;
}

on message HU_EmergencyLight_CTL_MSG
{
  Emergency = this.EmergencyLight_OnOff;
  EmergencyFlag = 1;
}

// OTA 업데이트 승인 여부 CAN 메세지 수신
on message HU_UpdateAcceptDecline_CTL_MSG
{
  rxOtaAssign = this.UpdateAcceptDecline_Signal;
  otaAssignFlag = 1;
}

on message HU_Alive_INFO_20MSG
{
  rxCanHU_Alive = this.HU_Alive;
}

on message HU_OTAResult_STATUS_MSG
{  
  rxCanHU_OTA = this.HU_OTAResult;
  otaFlag = 1;
}

on message HVAC_Alive_INFO_20MSG
{
  rxCanHVAC_Alive = this.HVAC_Alive;
}

on message HVAC_OTAResult_STATUS_MSG
{
  rxCanHVAC_OTA = this.HVAC_OTAResult;
  otaFlag = 1;
}