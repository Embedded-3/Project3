/*@!Encoding:65001*/
includes
{
  
}


variables
{
  int isSleeping = 1; // 초기 상태는 절전
}

// 0. 시뮬레이션 시작 시 절전 진입
on start
{
  isSleeping = 1;
  write("HU: Sleep mode entered.");
}

// 1. MZCU_WakeUp_CTL_MSG 메시지 수신 시 HU 깨움
on message MZCU_WakeUp_CTL_MSG
{
  if (isSleeping)
  {
    isSleeping = 0;
    write("HU: Wake-up triggered by CAN message.");
    // HU_Alive 시그널 -> 1 : IL 메시지 전송 시작 (주기적 전송 포함)
    $HU_Alive = 1;
  }
  
}

// 2. OTA 메세지 대응
on message MZCU_UpdateAlarm_INFO_MSG
{ // OTA status 관련 메시지 들어옴
  if(this.Update_ID == 1){ 
    @sysvar::MIDDLE::HU::OTA_Staus=1;  
  }
  else{
    @sysvar::MIDDLE::HU::OTA_Staus=1;
  }
}

on sysvar sysvar::MIDDLE::HU::OTA_Accept
{
  if(@sysvar::MIDDLE::HU::OTA_Staus!=1){
    return;
  }

  if(@sysvar::MIDDLE::HU::OTA_Accept==1){
    message HU_UpdateAcceptDecline_CTL_MSG update_msg;
    update_msg.UpdateAcceptDecline_Signal = 1;
    output(update_msg);
    
    
  }
} // not yet


on sysvar sysvar::MIDDLE::HU::OTA_Deny
{
  if(@sysvar::MIDDLE::HU::OTA_Staus!=1){
    return;
  }

  if(@sysvar::MIDDLE::HU::OTA_Accept==1){
    message HU_UpdateAcceptDecline_CTL_MSG update_msg;
    update_msg.UpdateAcceptDecline_Signal = 0;
    output(update_msg);
    
    @sysvar::MIDDLE::HU::OTA_Staus=0; // 이때는 바로 꺼짐
  }
} // OK

on message MZCU_OTA_HU_MSG{
  message HU_OTAResult_STATUS_MSG HU_OTA_msg;
  HU_OTA_msg.HU_OTAResult = 1;
  output(HU_OTA_msg);
  @sysvar::MIDDLE::HU::OTA_Staus=0; // 완료되면 OTA 아이콘 끄기
}  // 일단 무조건 성공

// 3. Run상태에서 SystemValue가 변경 될 때 CTL 메세지 전송
on sysvar sysvar::MIDDLE::HU::HVAC::Aircon_OnOff
{
  if(isSleeping == 0)
  {
    message HU_AirCon_CTL_MSG aircon_msg;
    aircon_msg.AirCon_OnOff = @sysvar::MIDDLE::HU::HVAC::Aircon_OnOff;
    aircon_msg.AirCon_Output = @sysvar::MIDDLE::HU::HVAC::Aircon_Value;
    output(aircon_msg);
  }
} // 에어컨 onoff OK

on sysvar sysvar::MIDDLE::HU::HVAC::Aircon_Up
{
   if(isSleeping == 0 || @sysvar::MIDDLE::HU::HVAC::Aircon_OnOff == 1)
   {
      message HU_AirCon_CTL_MSG aircon_msg;
      @sysvar::MIDDLE::HU::HVAC::Aircon_Value += 1;
      aircon_msg.AirCon_OnOff = @sysvar::MIDDLE::HU::HVAC::Aircon_OnOff;
      aircon_msg.AirCon_Output = @sysvar::MIDDLE::HU::HVAC::Aircon_Value;
      output(aircon_msg);
   }
} // 온도 올리기 OK

on sysvar sysvar::MIDDLE::HU::HVAC::Aircon_Down
{
   if(isSleeping == 0 || @sysvar::MIDDLE::HU::HVAC::Aircon_OnOff == 1)
   {
      message HU_AirCon_CTL_MSG aircon_msg;
      @sysvar::MIDDLE::HU::HVAC::Aircon_Value -= 1;
      aircon_msg.AirCon_OnOff = @sysvar::MIDDLE::HU::HVAC::Aircon_OnOff;
      aircon_msg.AirCon_Output = @sysvar::MIDDLE::HU::HVAC::Aircon_Value;
      output(aircon_msg);
   }
} // 온도 내리기 OK

on sysvar sysvar::MIDDLE::HU::HVAC::Heating_OnOff
{
  if(isSleeping == 0)
  {
    message HU_Heating_CTL_MSG heat_msg;
    heat_msg.Heating_OnOff = @sysvar::MIDDLE::HU::HVAC::Heating_OnOff;
    output(heat_msg);
  }
}

on sysvar sysvar::MIDDLE::HU::Mode_CTL
{
  if(isSleeping == 0)
  {
    message HU_ModeConvert_CTL_MSG mode_msg;
    if(@MIDDLE::HU::Mode_CTL)
    {
      mode_msg.External_Mode = 0;
      mode_msg.Internal_Mode = 1;
    }
    else
    {
      mode_msg.External_Mode = 1;
      mode_msg.Internal_Mode = 0;
    }
    output(mode_msg);
  }
}


on sysvar sysvar::MIDDLE::HU::ObstacleDetectionDistance
{
  if(isSleeping == 0)
  {
    message HU_ObsDetectDist_INFO_MSG dist_msg;
    dist_msg.ObstacleDetectDistance_Signal = @MIDDLE::HU::ObstacleDetectionDistance;
    output(dist_msg);
  }
} // OK

on sysvar sysvar::MIDDLE::HU::SoundAlert_ONOFF_CTL
{
  if(isSleeping == 0)
  {
    message HU_SoundAlertOnOff_CTL_MSG alert_msg;    
    alert_msg.SoundAlertOnOff_Signal = @MIDDLE::HU::SoundAlert_ONOFF_CTL;
    output(alert_msg);
  }
} // ok





// -------------------------- HVAC에서 안받아도 될거같아서 일단 주석

//on message HVAC_AirCon_STATUS_100MSG
//{
//   if(isSleeping == 0)
//  {
//    @sysvar::MIDDLE::HU::HVAC::Aircon_ONOFF_Status = this.Aircon_OnOff_Status;
//  }
//}

//on message HVAC_Heating_STATUS_100MSG
//{
//  if(isSleeping == 0)
//  {
//    @sysvar::MIDDLE::HU::HVAC::Heating_ONOFF_Status = this.Heating_OnOff_Status;
//  }
//}
// --------------------

on sysvar sysvar::MIDDLE::HU::HVAC::HVAC_Mode_Status{
  message HU_ModeConvert_CTL_MSG mode_msg;
  if(@sysvar::MIDDLE::HU::HVAC::HVAC_Mode_Status == 1){
    mode_msg.Internal_Mode = 1;
    mode_msg.External_Mode = 0;
  }
  else{
    mode_msg.Internal_Mode = 0;
    mode_msg.External_Mode = 1;
  }
  output(mode_msg);
}

on message HVAC_IntTemp_INFO_100MSG
{
  if(isSleeping == 0)
  {
    @sysvar::MIDDLE::HU::HVAC::Temperature_Value = this.Internal_Temperature;
  }
} // OK

on message HVAC_IntHumi_INFO_100MSG
{
  if(isSleeping == 0)
  {
    @sysvar::MIDDLE::HU::HVAC::Humidity_Value = this.Internal_Humidity;
  }
} // OK


// 비상등
on sysvar sysvar::MIDDLE::HU::Emergency
{
  if(isSleeping == 0)
  {
    message HU_EmergencyLight_CTL_MSG emergency_msg;
    emergency_msg.EmergencyLight_OnOff = @this;
    output(emergency_msg);
  }
}
