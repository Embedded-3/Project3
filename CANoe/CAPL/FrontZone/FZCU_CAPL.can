/*@!Encoding:65001*/
includes
{
  #include "../includes/eth_frame.can"
}

variables
{
  msTimer loop10ms;
  mstImer loop20ms;
  msTimer loopFlagInit5ms;
  
  byte wakeupFlag; // 0 : sleep 1 : wakeup

  int counter_10ms;
  int counter_20ms;
  
  int port_id;
  int allcan_port_id;
  
  ethernetPacket globalEthPkt;

  ethernetPacket CarControlUdpMsg;
  ethernetPacket OtaResultUdpMsg;
  ethernetPacket AdasOnOffUdpMsg;
  ethernetPacket HeadLampMiddleUdpMsg;
  ethernetPacket AliveUdpMsg;
  ethernetPacket HeadLampRearUdpMsg;
  ethernetPacket McuControlUdpMsg;
  ethernetPacket WakeUpCallMsg;

  // TX FRAME
  struct FrontHpcCarControlFrame frontHpcCarControl10msFrame;
  struct FrontHpcOtaResultFrame frontHpcOtaResultFrame;
  struct FrontHpcAdasOnOffFrame frontHpcAdasOnOff10msFrame;
  struct FrontMiddleHeadLampMiddleFrame frontMiddleHeadLampMiddle10msFrame;
  struct FrontMiddleAliveFrame frontMiddleAlive20msFrame;
  struct FrontRearHeadLampRearFrame frontRearHeadLampRear10msFrame;
  struct FrontRearMcuControlFrame frontRearMcuControl10msFrame;
  struct FrontHpcWakeUpCallFrame frontHpcWakeupCallFrame;
  
  // RX FRAME
  struct HpcFrontLkasFrame rxLkasFrame;
  struct HpcFrontOtaFrontFrame rxOtaFrontFrame;
  
  // RX FRAME(ALL)
  struct HpcAllEsaFrame rxEsaFrame;
  struct HpcAllWakeUpFrame rxWakeUpFrame;
  
  byte LkasFrameReceived20ms;
  byte OtaFrontFrameReceived10ms;
  byte EsaFrameReceived20ms;
  byte WakeUpReceived;
}


on start
{
  counter_10ms = 0;
  counter_20ms = 0;
  wakeupFlag = 0;
  
  LkasFrameReceived20ms = 0;
  OtaFrontFrameReceived10ms = 0;
  EsaFrameReceived20ms = 0;
  WakeUpReceived = 0;
  
  setTimerCyclic(loop10ms, 10);
  setTimerCyclic(loop20ms, 20);
  setTimerCyclic(loopFlagInit5ms, 5);
  
  initUdpPacket(FZCU_MAC_ADDR, HPC_MAC_ADDR, FZCU_IP_ADDR, HPC_IP_ADDR,
                FRONT_TX_PORT_BASE, HPC_RX_PORT_BASE, FRONT_CARCONTROL_TX_PORT_ID, HPC_CARCONTROL_RX_PORT_ID);
  CarControlUdpMsg = globalEthPkt;
  
  initUdpPacket(FZCU_MAC_ADDR, HPC_MAC_ADDR, FZCU_IP_ADDR, HPC_IP_ADDR,
                FRONT_TX_PORT_BASE, HPC_RX_PORT_BASE, FRONT_OTARESULT_TX_PORT_ID, HPC_OTARESULT_FRONT_RX_PORT_ID);
  OtaResultUdpMsg = globalEthPkt;
  
  initUdpPacket(FZCU_MAC_ADDR, HPC_MAC_ADDR, FZCU_IP_ADDR, HPC_IP_ADDR,
                FRONT_TX_PORT_BASE, HPC_RX_PORT_BASE, FRONT_ADAS_ONOFF_TX_PORT_ID, HPC_ADAS_ONOFF_RX_PORT_ID);
  AdasOnOffUdpMsg = globalEthPkt;
  
  initUdpPacket(FZCU_MAC_ADDR, MZCU_MAC_ADDR, FZCU_IP_ADDR, MZCU_IP_ADDR,
                FRONT_TX_PORT_BASE, MIDDLE_RX_PORT_BASE, FRONT_HEADLAMP_MIDDLE_TX_PORT_ID, MIDDLE_HEADLAMP_STATUS_TX_PORT_ID);
  HeadLampMiddleUdpMsg = globalEthPkt;
  
  initUdpPacket(FZCU_MAC_ADDR, MZCU_MAC_ADDR, FZCU_IP_ADDR, MZCU_IP_ADDR,
                FRONT_TX_PORT_BASE, MIDDLE_RX_PORT_BASE, FRONT_ALIVE_TX_PORT_ID, MIDDLE_ALIVE_FRONT_RX_PORT_ID);
  AliveUdpMsg = globalEthPkt;
  
  initUdpPacket(FZCU_MAC_ADDR, RZCU_MAC_ADDR, FZCU_IP_ADDR, RZCU_IP_ADDR,
                FRONT_TX_PORT_BASE, REAR_RX_PORT_BASE, FRONT_HEADLAMP_REAR_TX_PORT_ID, REAR_HEADLAMP_REAR_RX_PORT_ID);
  HeadLampRearUdpMsg = globalEthPkt;
  
  initUdpPacket(FZCU_MAC_ADDR, RZCU_MAC_ADDR, FZCU_IP_ADDR, RZCU_IP_ADDR,
                FRONT_TX_PORT_BASE, REAR_RX_PORT_BASE, FRONT_MCUCONTROL_TX_PORT_ID, REAR_MCUCONTROL_RX_PORT_ID);
  McuControlUdpMsg = globalEthPkt;
  
  initUdpPacket(FZCU_MAC_ADDR, HPC_MAC_ADDR, FZCU_IP_ADDR, HPC_IP_ADDR,
                FRONT_TX_PORT_BASE, HPC_RX_PORT_BASE, FRONT_WAKEUPCALL_TX_PORT_ID, HPC_WAKEUPCALL_RX_PORT_ID);
  WakeUpCallMsg = globalEthPkt;
}

on key 'w'
{
  frontHpcWakeupCallFrame.WakeUp_Call = 1;
  WakeUpCallMsg.udp.SetData(0, frontHpcWakeupCallFrame);
  WakeUpCallMsg.CompletePacket();
  output(WakeUpCallMsg);
  write("[TX] [front->hpc] wake up call message sent at beginning^^");
}

on timer loopFlagInit5ms
{
  if(wakeupFlag == 0) return;
  
  OtaFrontFrameReceived10ms = 0;
  LkasFrameReceived20ms = 0;
  EsaFrameReceived20ms = 0;
  WakeUpReceived = 0;
}

on timer loop10ms
{
  if(wakeupFlag == 0) return;
  
  counter_10ms++;
  
  frontHpcCarControl10msFrame.User_Steering_Angle = 1; // need to connect
  frontHpcCarControl10msFrame.Accel_Pedal_Pos     = 1; // need to connect
  frontHpcCarControl10msFrame.Brake_Pedal_Pos     = 1; // need to connect
  frontHpcCarControl10msFrame.Gear_Position       = 1; // need to connect
  frontHpcCarControl10msFrame.Ignition_Status     = 1; // need to connect
  CarControlUdpMsg.udp.SetData(0, frontHpcCarControl10msFrame);
  CarControlUdpMsg.CompletePacket();
  output(CarControlUdpMsg);
  write("[TX] [front->hpc] CarControl msg sent at %d ms", 10 * counter_10ms);
  
  frontHpcAdasOnOff10msFrame.ADAS_On_Off_Status = 1; // need to connect
  AdasOnOffUdpMsg.udp.SetData(0, frontHpcAdasOnOff10msFrame);
  AdasOnOffUdpMsg.CompletePacket();
  output(AdasOnOffUdpMsg);
  write("[TX] [front->hpc] Adas onoff msg sent at %d ms", 10 * counter_10ms);
  
  frontMiddleHeadLampMiddle10msFrame.HeadLamp_Middle_Status = 1; // need to connect
  HeadLampMiddleUdpMsg.udp.SetData(0, frontMiddleHeadLampMiddle10msFrame);
  HeadLampMiddleUdpMsg.CompletePacket();
  output(HeadLampMiddleUdpMsg);
  write("[TX] [front->middle] Head Lamp Middle msg sent at %d ms", 10 * counter_10ms);
  
  frontRearHeadLampRear10msFrame.HeadLamp_Rear_Status = 1; // need to connect
  HeadLampRearUdpMsg.udp.SetData(0, frontRearHeadLampRear10msFrame);
  HeadLampRearUdpMsg.CompletePacket();
  output(HeadLampRearUdpMsg);
  write("[TX] [front->rear] Head Lamp Rear msg sent at %d ms", 10 * counter_10ms);
  
  frontRearMcuControl10msFrame.LeftRear_RPM = 10; // need to connect
  frontRearMcuControl10msFrame.RightRear_RPM = 10; // need to connect
  McuControlUdpMsg.udp.SetData(0, frontRearMcuControl10msFrame);
  McuControlUdpMsg.CompletePacket();
  output(McuControlUdpMsg);
  write("[TX] [front->rear] Mcu control msg sent at %d ms", 10 * counter_10ms);
  
}

on timer loop20ms
{
  if(wakeupFlag == 0) return;
  
  counter_20ms++;
  
  frontMiddleAlive20msFrame.ECU_Alive_Status = 1; // need to connect
  AliveUdpMsg.udp.SetData(0, frontMiddleAlive20msFrame);
  AliveUdpMsg.CompletePacket();
  output(AliveUdpMsg);
  write("[TX] [front->middle] Front Alive msg sent at %d ms", 10 * counter_10ms);
}


on ethernetPacket *
{
  ip_Endpoint endPointDst;

  this.GetDestinationIPEndpoint(endPointDst);
  
  port_id = (int)(endPointDst.PortNumber - FRONT_RX_PORT_BASE);
  allcan_port_id = (int)(endPointDst.PortNumber - ALLCAN_RX_PORT_BASE);
  
  switch(allcan_port_id)
  {
    case ALLCAN_ESA_RX_PORT_ID:
      if(EsaFrameReceived20ms) return;
      EsaFrameReceived20ms = 1;
      this.udp.getData(0, rxEsaFrame);
      write("[RX] [hpc->front] ESA SteeringAngle : %d", rxEsaFrame.ESA_Steering_Angle);
      break;
    case ALLCAN_WAKEUP_RX_PORT_ID:
      if(WakeUpReceived) return;
      WakeUpReceived = 1;
      this.udp.getData(0, rxWakeUpFrame);
      wakeupFlag = 1;
      write("[RX] [hpc->front] Wake up message");
      break;
    default:
      break;
  }
  
  // ESA Message
  if (endPointDst.PortNumber - ALLCAN_RX_PORT_BASE == ALLCAN_ESA_RX_PORT_ID)
  {
    if(EsaFrameReceived20ms) return;
    EsaFrameReceived20ms = 1;
    this.udp.getData(0, rxEsaFrame);
    write("[RX] [hpc->front] ESA SteeringAngle : %d", rxEsaFrame.ESA_Steering_Angle);
    return;
  }
  
  switch (port_id)
  {
    case FRONT_LKAS_RX_PORT_ID:
      if (LkasFrameReceived20ms) break;
      LkasFrameReceived20ms = 1;
      this.udp.GetData(0, rxLkasFrame);
      write("[RX] [hpc->front] LKAS SteeringAngle : %d", rxLkasFrame.LKAS_Steering_Angle);
      break;
    case FRONT_OTAFRONT_RX_PORT_ID:
      if (OtaFrontFrameReceived10ms) break;
      OtaFrontFrameReceived10ms = 1;
      this.udp.GetData(0, rxOtaFrontFrame);
      write("[RX] [hpc->front] OTA FRONT GOGO");
      break;
    default:
      break;
  }
}

void initUdpPacket(char TX_MAC_ADDR[], char RX_MAC_ADDR[],
                  char TX_IP_ADDR[], char RX_IP_ADDR[],
                  long TX_PORT_BASE, long RX_PORT_BASE,
                  long TX_PORT_ID, long RX_PORT_ID)
{
  globalEthPkt.source = ethGetMacAddressAsNumber(TX_MAC_ADDR);
  globalEthPkt.destination = ethGetMacAddressAsNumber(RX_MAC_ADDR);
  globalEthPkt.udp.init();
  globalEthPkt.type = 0x0800;
  globalEthPkt.Length = 104;
  globalEthPkt.udp.length = 64;
  globalEthPkt.ipv4.source.ParseAddress(TX_IP_ADDR);
  globalEthPkt.ipv4.destination.ParseAddress(RX_IP_ADDR);
  globalEthPkt.udp.source = TX_PORT_BASE + TX_PORT_ID;
  globalEthPkt.udp.destination = RX_PORT_BASE + RX_PORT_ID;

  /*
  이후 해야할 일
  struct myFrame 초기화
  ethpkt->setData(0, myFrame);
  ethpkt->Length = (length); (OTA는 길게 해야함)
  ethpkt->CompletePacket();
  output(*ethpkt)
  */
}