/*@!Encoding:65001*/
includes
{
  #include "../includes/eth_frame.can"
}

variables
{
  msTimer loop10ms;
  mstImer loop20ms;
  msTimer loopFlagInit5ms;
  
  byte wakeupFlag; // 0 : sleep 1 : 
  
  //CAN TX Flag
  byte WakeUp_CANTX_FLAG;
  byte ESA_CANTX_FLAG;
  byte LKAS_CANTX_FLAG;
  byte OTA_CANTX_FLAG;
  
  //Eth TX flag
  byte OTAResult_TX_FLAG;

  int counter_10ms;
  int counter_20ms;
  
  int port_id;
  int allcan_port_id;
  
  message FZCU_Brake_CTL_10MSG brake_ctl_msg;
  message FZCU_Steering_CTL_MSG steering_msg;
  message FZCU_WakeUp_CTL_MSG wakeup_ctl_msg;
  message FZCU_OTA_VCU_MSG        ota_vcu_msg;
  message FZCU_OTA_ABS_MSG        ota_abs_msg;
  message FZCU_OTA_MDPS_MSG       ota_mdps_msg;
  message FZCU_OTA_MFS_MSG        ota_mfs_msg;
  
  ethernetPacket globalEthPkt;

  ethernetPacket CarControlUdpMsg;
  ethernetPacket OtaResultUdpMsg;
  ethernetPacket AdasOnOffUdpMsg;
  ethernetPacket HeadLampMiddleUdpMsg;
  ethernetPacket AliveUdpMsg;
  ethernetPacket HeadLampRearUdpMsg;
  ethernetPacket McuControlUdpMsg;
  ethernetPacket WakeUpCallMsg;

  // TX FRAME
  struct FrontHpcCarControlFrame frontHpcCarControl10msFrame;
  struct FrontHpcOtaResultFrame frontHpcOtaResultFrame;
  struct FrontHpcAdasOnOffFrame frontHpcAdasOnOff10msFrame;
  struct FrontMiddleHeadLampMiddleFrame frontMiddleHeadLampMiddle10msFrame;
  struct FrontMiddleAliveFrame frontMiddleAlive20msFrame;
  struct FrontRearHeadLampRearFrame frontRearHeadLampRear10msFrame;
  struct FrontRearMcuControlFrame frontRearMcuControl10msFrame;
  struct FrontHpcWakeUpCallFrame frontHpcWakeupCallFrame;
  
  // RX FRAME
  struct HpcFrontLkasFrame rxLkasFrame;
  struct HpcFrontOtaFrontFrame rxOtaFrontFrame;
  
  // RX FRAME(ALL)
  struct HpcAllEsaFrame rxEsaFrame;
  struct HpcAllWakeUpFrame rxWakeUpFrame;
  
  //===============Front ZCU VARIABLES====================//
  byte FrontCanAliveState;
  byte FrontCanOTAState;
  
  byte rxCanMFS_Alive;
  byte rxCanABS_Alive;
  byte rxCanMDPS_Alive;
  byte rxCanVCU_Alive;
  
  byte rxCanMFS_OTA;
  byte rxCanABS_OTA;
  byte rxCanMDPS_OTA;
  byte rxCanVCU_OTA;
  
  byte LkasFrameReceived20ms;
  byte OtaFrontFrameReceived10ms;
  byte EsaFrameReceived20ms;
  byte WakeUpReceived;
  
  int i, j;
  qword ota_value;
}


on start
{
  counter_10ms = 0;
  counter_20ms = 0;
  wakeupFlag = 0;
  
  // CAN Eth TX flag = 0 초기화
  OTAResult_TX_FLAG = 0;
  WakeUp_CANTX_FLAG = 0;
  ESA_CANTX_FLAG = 0;
  LKAS_CANTX_FLAG = 0;
  
  LkasFrameReceived20ms = 0;
  OtaFrontFrameReceived10ms = 0;
  EsaFrameReceived20ms = 0;
  WakeUpReceived = 0;
  FrontCanAliveState = 0;
  
  setTimerCyclic(loop10ms, 10);
  setTimerCyclic(loop20ms, 20);
  setTimerCyclic(loopFlagInit5ms, 5);
  
  initUdpPacket(FZCU_MAC_ADDR, HPC_MAC_ADDR, FZCU_IP_ADDR, HPC_IP_ADDR,
                FRONT_TX_PORT_BASE, HPC_RX_PORT_BASE, FRONT_CARCONTROL_TX_PORT_ID, HPC_CARCONTROL_RX_PORT_ID);
  CarControlUdpMsg = globalEthPkt;
  
  initUdpPacket(FZCU_MAC_ADDR, HPC_MAC_ADDR, FZCU_IP_ADDR, HPC_IP_ADDR,
                FRONT_TX_PORT_BASE, HPC_RX_PORT_BASE, FRONT_OTARESULT_TX_PORT_ID, HPC_OTARESULT_FRONT_RX_PORT_ID);
  OtaResultUdpMsg = globalEthPkt;
  
  initUdpPacket(FZCU_MAC_ADDR, HPC_MAC_ADDR, FZCU_IP_ADDR, HPC_IP_ADDR,
                FRONT_TX_PORT_BASE, HPC_RX_PORT_BASE, FRONT_ADAS_ONOFF_TX_PORT_ID, HPC_ADAS_ONOFF_RX_PORT_ID);
  AdasOnOffUdpMsg = globalEthPkt;
  
  initUdpPacket(FZCU_MAC_ADDR, MZCU_MAC_ADDR, FZCU_IP_ADDR, MZCU_IP_ADDR,
                FRONT_TX_PORT_BASE, MIDDLE_RX_PORT_BASE, FRONT_HEADLAMP_MIDDLE_TX_PORT_ID, MIDDLE_HEADLAMP_STATUS_TX_PORT_ID);
  HeadLampMiddleUdpMsg = globalEthPkt;
  
  initUdpPacket(FZCU_MAC_ADDR, MZCU_MAC_ADDR, FZCU_IP_ADDR, MZCU_IP_ADDR,
                FRONT_TX_PORT_BASE, MIDDLE_RX_PORT_BASE, FRONT_ALIVE_TX_PORT_ID, MIDDLE_ALIVE_FRONT_RX_PORT_ID);
  AliveUdpMsg = globalEthPkt;
  
  initUdpPacket(FZCU_MAC_ADDR, RZCU_MAC_ADDR, FZCU_IP_ADDR, RZCU_IP_ADDR,
                FRONT_TX_PORT_BASE, REAR_RX_PORT_BASE, FRONT_HEADLAMP_REAR_TX_PORT_ID, REAR_HEADLAMP_REAR_RX_PORT_ID);
  HeadLampRearUdpMsg = globalEthPkt;
  
  initUdpPacket(FZCU_MAC_ADDR, RZCU_MAC_ADDR, FZCU_IP_ADDR, RZCU_IP_ADDR,
                FRONT_TX_PORT_BASE, REAR_RX_PORT_BASE, FRONT_MCUCONTROL_TX_PORT_ID, REAR_MCUCONTROL_RX_PORT_ID);
  McuControlUdpMsg = globalEthPkt;
  
  initUdpPacket(FZCU_MAC_ADDR, HPC_MAC_ADDR, FZCU_IP_ADDR, HPC_IP_ADDR,
                FRONT_TX_PORT_BASE, HPC_RX_PORT_BASE, FRONT_WAKEUPCALL_TX_PORT_ID, HPC_WAKEUPCALL_RX_PORT_ID);
  WakeUpCallMsg = globalEthPkt;
}

on key 'w'
{
  frontHpcWakeupCallFrame.WakeUp_Call = 1;
  WakeUpCallMsg.udp.SetData(0, frontHpcWakeupCallFrame);
  WakeUpCallMsg.CompletePacket();
  output(WakeUpCallMsg);
  write("[TX] [front->hpc] wake up call message sent at beginning^^");
}

on timer loopFlagInit5ms
{
  if(wakeupFlag == 0) return;
  
  OtaFrontFrameReceived10ms = 0;
  LkasFrameReceived20ms = 0;
  EsaFrameReceived20ms = 0;
  WakeUpReceived = 0;
}

on timer loop10ms
{
  if(wakeupFlag == 0) return;
  
  /*
  counter_10ms++;

  frontHpcCarControl10msFrame.User_Steering_Angle = 1; // need to connect
  frontHpcCarControl10msFrame.Accel_Pedal_Pos     = 1; // need to connect
  frontHpcCarControl10msFrame.Brake_Pedal_Pos     = 1; // need to connect
  frontHpcCarControl10msFrame.Gear_Position       = 1; // need to connect
  frontHpcCarControl10msFrame.Ignition_Status     = 1; // need to connect
  */
  
  //Periodic Eth MSG
  // 0. WakeUpCallMsg - Event : on message VCU_VehicleStart_STATUS_100MSG
  
  // 1. CarControlUdpMsg - Cycle 
  CarControlUdpMsg.udp.SetData(0, frontHpcCarControl10msFrame);
  CarControlUdpMsg.CompletePacket();
  output(CarControlUdpMsg);
  write("[TX] [front->hpc] CarControl");
  //write("[TX] [front->hpc] CarControl msg sent at %d ms", 10 * counter_10ms);
  
  // 2. OtaResultUdpMsg - Event
  // CAN 에서 OTA 응답 메세지가 들어올 때
  if(OTAResult_TX_FLAG)
  {
    OTA_CANTX_FLAG = 0;
    FrontCanOTAState = 0;
    FrontCanOTAState |= (1 << 7);
    FrontCanOTAState |= rxCanMDPS_OTA << 6;
    FrontCanOTAState |= rxCanABS_OTA << 5;
    FrontCanOTAState |= rxCanMFS_OTA << 4;
    FrontCanOTAState |= rxCanVCU_OTA << 3;
    frontHpcOtaResultFrame.ECU_OTA_Result = FrontCanOTAState;
    OtaResultUdpMsg.udp.SetData(0, frontHpcOtaResultFrame);
    OtaResultUdpMsg.CompletePacket();
    output(OtaResultUdpMsg);
    write("[TX] [front->hpc] OTA onoff msg");
  }
  
  // 3. AdasOnOffUdpMsg - Cycle
  AdasOnOffUdpMsg.udp.SetData(0, frontHpcAdasOnOff10msFrame);
  AdasOnOffUdpMsg.CompletePacket();
  output(AdasOnOffUdpMsg);
  write("[TX] [front->hpc] Adas onoff msg");
  //write("[TX] [front->hpc] Adas onoff msg sent at %d ms", 10 * counter_10ms);
  
  
  // 4. HeadLampMiddleUdpMsg - Cycle
  HeadLampMiddleUdpMsg.udp.SetData(0, frontMiddleHeadLampMiddle10msFrame);
  HeadLampMiddleUdpMsg.CompletePacket();
  output(HeadLampMiddleUdpMsg);
  write("[TX] [front->middle] Head Lamp Middle");
  //write("[TX] [front->middle] Head Lamp Middle msg sent at %d ms", 10 * counter_10ms);
  
  // 5. AliveUdpMsg - Cycle : on timer loop20ms
  
  // 6. HeadLampRearUdpMsg - Cycle
  //frontRearHeadLampRear10msFrame.HeadLamp_Rear_Status = 1; // need to connect
  HeadLampRearUdpMsg.udp.SetData(0, frontRearHeadLampRear10msFrame);
  HeadLampRearUdpMsg.CompletePacket();
  output(HeadLampRearUdpMsg);
  write("[TX] [front->rear] Head Lamp Rear msg");
  //write("[TX] [front->rear] Head Lamp Rear msg sent at %d ms", 10 * counter_10ms);
  
  // 7. McuControlUdpMsg - Cycle
  McuControlUdpMsg.udp.SetData(0, frontRearMcuControl10msFrame);
  McuControlUdpMsg.CompletePacket();
  output(McuControlUdpMsg);
  write("[TX] [front->rear] Mcu control msg sent at %d ms", 10 * counter_10ms);
  
  
  //CAN TX
  /*
  FZCU_Brake_CTL_10MSG
  FZCU_WakeUp_CTL_MSG   O
  FZCU_Steering_CTL_MSG O
  */
  if(WakeUp_CANTX_FLAG)
  {
    WakeUp_CANTX_FLAG = 0;
    wakeup_ctl_msg.FZCU_Wakeup = rxWakeUpFrame.WakeUp_ALL_ECU;
    output(wakeup_ctl_msg);
    write("FZCU : [CAN][WakeUp] Send Wake up CAN message");
  }
  if(ESA_CANTX_FLAG)
  {
    ESA_CANTX_FLAG = 0;
    steering_msg.Steering_Angle = rxEsaFrame.ESA_Steering_Angle;
    output(steering_msg);
    write("FZCU : [CAN][ESA] SteeringAngle : %d", steering_msg.Steering_Angle);
  }
  if(LKAS_CANTX_FLAG){
    LKAS_CANTX_FLAG = 0;
    steering_msg.Steering_Angle = rxLkasFrame.LKAS_Steering_Angle;
    output(steering_msg);
    write("FZCU : [CAN][LKAS] SteeringAngle : %d", steering_msg.Steering_Angle);
  }
}

on timer loop20ms
{
  if(wakeupFlag == 0) return;
  
  FrontCanAliveState = 0;
  FrontCanAliveState |= (1 << 7);
  FrontCanAliveState |= rxCanMDPS_Alive;
  FrontCanAliveState |= rxCanABS_Alive;
  FrontCanAliveState |= rxCanMFS_Alive;
  FrontCanAliveState |= rxCanVCU_Alive;
  frontMiddleAlive20msFrame.ECU_Alive_Status = FrontCanAliveState;
  AliveUdpMsg.udp.SetData(0, frontMiddleAlive20msFrame);
  AliveUdpMsg.CompletePacket();
  output(AliveUdpMsg);
  write("[TX] [front->middle] Front Alive msg");
  rxCanMDPS_Alive = 0;
  rxCanABS_Alive = 0;
  rxCanMFS_Alive = 0;
  rxCanVCU_Alive = 0;
}


on ethernetPacket *
{
  ip_Endpoint endPointDst;

  this.GetDestinationIPEndpoint(endPointDst);
  
  port_id = (int)(endPointDst.PortNumber - FRONT_RX_PORT_BASE);
  allcan_port_id = (int)(endPointDst.PortNumber - ALLCAN_RX_PORT_BASE);
  
  switch(allcan_port_id)
  {
    case ALLCAN_ESA_RX_PORT_ID:
      if(EsaFrameReceived20ms) return;
      EsaFrameReceived20ms = 1;
      ESA_CANTX_FLAG = 1;
      this.udp.getData(0, rxEsaFrame);
      write("FZCU : [RX] [hpc->front] ESA SteeringAngle : %d", rxEsaFrame.ESA_Steering_Angle);
      break;
    case ALLCAN_WAKEUP_RX_PORT_ID:
      if(WakeUpReceived) return;
      wakeupFlag = 1;
      WakeUpReceived = 1;
      WakeUp_CANTX_FLAG = 1;
      this.udp.getData(0, rxWakeUpFrame);
      write("FZCU : [RX] [hpc->front] Wake up message");
      
      wakeup_ctl_msg.FZCU_Wakeup = rxWakeUpFrame.WakeUp_ALL_ECU;
      output(wakeup_ctl_msg);
      write("FZCU : [CAN][WakeUp] Send Wake up CAN message");
      
      break;
    default:
      break;
  }
  
  
  switch (port_id)
  {
    case FRONT_LKAS_RX_PORT_ID:
      if (LkasFrameReceived20ms) break;
      LkasFrameReceived20ms = 1;
      LKAS_CANTX_FLAG = 1;
      this.udp.GetData(0, rxLkasFrame);
      write("FZCU : [RX] [hpc->front] LKAS SteeringAngle : %d", rxLkasFrame.LKAS_Steering_Angle);
      break;
    case FRONT_OTAFRONT_RX_PORT_ID: 
      if (OtaFrontFrameReceived10ms) break;
      OtaFrontFrameReceived10ms = 1;
      this.udp.GetData(0, rxOtaFrontFrame);
      write("[RX] [hpc->front] OTA FRONT GOGO");
      
      for (i = 0; i < rxOtaFrontFrame.Total_Byte; i += 8)
      {
        ota_value = 0;
        for (j = 0; j < 8; j++)
        {
          if (rxOtaFrontFrame.Total_Byte - i < j) break;
          ota_value |= rxOtaFrontFrame.Data[i+j];
          if (j != 7) ota_value = (ota_value << 8); // Endian 계산 정확한지 모르겠음.
        }
            
        // FZCU VCU ABS MDPS MFS
        // FZCU_OTA_VCU_MSG, FZCU_OTA_ABS_MSG, FZCU_OTA_MDPS_MSG, FZCU_OTA_MFS_MSG
        switch(rxOtaFrontFrame.ECU_Select)
        {
          case (1 << 7): // FZCU
            break;
          case (1 << 6): // VCU
            ota_vcu_msg.VCU_OTA = ota_value;
            output(ota_vcu_msg);
            break;
          case (1 << 5): // ABS
            ota_abs_msg.ABS_OTA = ota_value;
            output(ota_abs_msg);
            break;
          case (1 << 4):
            ota_mdps_msg.MDPS_OTA = ota_value;
            output(ota_mdps_msg);
            break;
          case (1 << 3):
            ota_mfs_msg.MFS_OTA = ota_value;
            output(ota_mfs_msg);
            break;
          default:
            break;
        }
      }
      break;
    default:
      break;
  }
}

void initUdpPacket(char TX_MAC_ADDR[], char RX_MAC_ADDR[],
                  char TX_IP_ADDR[], char RX_IP_ADDR[],
                  long TX_PORT_BASE, long RX_PORT_BASE,
                  long TX_PORT_ID, long RX_PORT_ID)
{
  globalEthPkt.source = ethGetMacAddressAsNumber(TX_MAC_ADDR);
  globalEthPkt.destination = ethGetMacAddressAsNumber(RX_MAC_ADDR);
  globalEthPkt.udp.init();
  globalEthPkt.type = 0x0800;
  globalEthPkt.Length = 104;
  globalEthPkt.udp.length = 64;
  globalEthPkt.ipv4.source.ParseAddress(TX_IP_ADDR);
  globalEthPkt.ipv4.destination.ParseAddress(RX_IP_ADDR);
  globalEthPkt.udp.source = TX_PORT_BASE + TX_PORT_ID;
  globalEthPkt.udp.destination = RX_PORT_BASE + RX_PORT_ID;

  /*
  이후 해야할 일
  struct myFrame 초기화
  ethpkt->setData(0, myFrame);
  ethpkt->Length = (length); (OTA는 길게 해야함)
  ethpkt->CompletePacket();
  output(*ethpkt)
  */
}

// ***CAN Message***
// 1. ignition -> 시동
on message VCU_VehicleStart_STATUS_100MSG
{ 
  frontHpcWakeupCallFrame.WakeUp_Call = this.Ignition_Status;
  frontHpcCarControl10msFrame.Ignition_Status = this.Ignition_Status;
  WakeUpCallMsg.udp.SetData(0, frontHpcWakeupCallFrame);
  WakeUpCallMsg.CompletePacket();
  output(WakeUpCallMsg);
  // 0. WakeUpCallMsg - Event : Eth Tx
  write("[TX] [front->hpc] wake up call message sent at beginning^^");
}

// 2. Gear
on message VCU_Transmission_STATUS_1000MSG
{
  frontHpcCarControl10msFrame.Gear_Position = this.Gear_Position;
}

// 3. Accel
on message VCU_AccPedal_CTL_10MSG
{
  frontHpcCarControl10msFrame.Accel_Pedal_Pos = this.Accel_Pedal_Pos;
}

// 4. Brake
on message VCU_BrakePedal_CTL_10MSG
{
  frontHpcCarControl10msFrame.Brake_Pedal_Pos = this.Brake_Pedal_Pos;
}


on message VCU_OTAResult_STATUS_MSG
{
  rxCanVCU_OTA = this.VCU_OTAResult << 6;
  OTAResult_TX_FLAG = 1;
}

on message VCU_Alive_INFO_20MSG
{
  rxCanVCU_Alive = this.VCU_Alive;
}

// 6. 계산된 RPM값 전송
on message VCU_MCU_CTL_10MSG
{
  frontRearMcuControl10msFrame.LeftRear_RPM = this.MCU_RPM_CTL;
}

on message ABS_BrakeOutput_STATUS_10MSG
{
}

on message ABS_Alive_INFO_20MSG
{
  rxCanABS_Alive = this.ABS_Alive;
}

on message ABS_OTAResult_STATUS_MSG
{
  //frontHpcOtaResultFrame.ECU_OTA_Result |= this.ABS_OTAResult << 5;
  rxCanABS_OTA = this.ABS_OTAResult;
  OTAResult_TX_FLAG = 1;
}

on message MDPS_Steering_INFO_10MSG
{
  frontHpcCarControl10msFrame.User_Steering_Angle = this.Steering_Angle;
}

on message MDPS_Switch_STATUS_10MSG
{
  frontHpcAdasOnOff10msFrame.ADAS_On_Off_Status = this.Mode_Button;
}

//
on message MDPS_HLBeam_CTL_MSG
{
  frontMiddleHeadLampMiddle10msFrame.HeadLamp_Middle_Status |= this.HighBeam << 7;
  frontMiddleHeadLampMiddle10msFrame.HeadLamp_Middle_Status |= this.LowBeam << 6;
  frontRearHeadLampRear10msFrame.HeadLamp_Rear_Status |= this.HighBeam << 7;
  frontRearHeadLampRear10msFrame.HeadLamp_Rear_Status |= this.LowBeam << 6;  
}

on message MDPS_RLTurnSignal_CTL_MSG
{
  frontMiddleHeadLampMiddle10msFrame.HeadLamp_Middle_Status |= this.LeftTurnSignal << 5;
  frontMiddleHeadLampMiddle10msFrame.HeadLamp_Middle_Status |= this.RightTurnSignal<< 4;
  frontRearHeadLampRear10msFrame.HeadLamp_Rear_Status |= this.LeftTurnSignal << 5;
  frontRearHeadLampRear10msFrame.HeadLamp_Rear_Status |= this.RightTurnSignal << 4;
}


on message MDPS_Alive_INFO_20MSG
{
  rxCanMDPS_Alive = this.MDPS_Alive;
}

on message MDPS_OTAResult_STATUS_MSG
{
  rxCanMDPS_OTA = this.MDPS_OTAResult;
  OTAResult_TX_FLAG = 1;
}

on message MFS_Alive_INFO_20MSG
{
  rxCanMFS_Alive = this.MFS_Alive;
}

on message MFS_OTAResult_STATUS_MSG
{
  rxCanMFS_OTA= this.MFS_OTAResult;
  OTAResult_TX_FLAG = 1;
}