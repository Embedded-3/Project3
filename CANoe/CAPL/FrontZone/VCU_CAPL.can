/*@!Encoding:65001*/
includes
{
  
}

variables
{
  msTimer loop;
  int timerCnt = 0;
  int RPM;
  byte gear;
  int state = 0; // 0: OFF, 1: STARTING, 
  
  message VCU_AccPedal_CTL_10MSG acc_msg; //X
  message VCU_BrakePedal_CTL_10MSG brk_msg; //X
  message VCU_VehicleStart_STATUS_100MSG ign_msg; // HPC
  message VCU_Transmission_STATUS_100MSG trans_msg; // MZCU::CLU
  message VCU_MCU_CTL_10MSG mcu_msg;  
}

// 0. 시뮬레이션 시작 시 절전 진입
on start
{
  state = 0;
  write("VCU: Sleep mode entered.");
  setTimerCyclic(loop, 10);
  gear = 0;
}

// 0. Run 상태에서 보낼 주기 메세지
on timer loop
{
  if(state)
  {
    timerCnt++;
    
    //액셀 브레이크 메세지 필요없음 -> FZoneDBC 삭제
    acc_msg.Accel_Pedal_Pos = @sysvar::FRONT::VCU::Accel_Pedal;
    output(acc_msg);
    
    brk_msg.Brake_Pedal_Pos = @sysvar::FRONT::VCU::Brake_Pedal;
    output(brk_msg);
    
    // 수정 : Transmission 추가 반영
    RPM = @sysvar::FRONT::VCU::Accel_Pedal * 400 - @sysvar::FRONT::VCU::Brake_Pedal *800;
    if(RPM < 0){
      RPM = 0;
    }
    
    mcu_msg.MCU_RPM_CTL  = RPM;
    output(mcu_msg);
    write("VCU : [CAN TX] MotorRPM_CTL %d", RPM);
    
    if(timerCnt % 10 == 0){
      // 시동
      ign_msg.Ignition_Status = @sysvar::FRONT::VCU::Ignition;
      output(ign_msg);
      
      // 기어
      trans_msg.Gear_Position = gear;
      write("VCU : gear %d", gear);
      output(trans_msg);
      timerCnt = 0;
    }
  }
}

// 1. FZCU_WakeUp_CTL_MSG 메시지 수신 시 VCU 깨움
on message FZCU_WakeUp_CTL_MSG
{
  if (!state && this.FZCU_Wakeup)
  {
    state = 1;
    write("VCU: Wake-up triggered by CAN message.");
    // VCU_Alive 시그널 -> 1 : IL 메시지 전송 시작 (주기적 전송 포함)
    $VCU_Alive = 1;
    
  }
  else if(!this.FZCU_Wakeup)
  {
    state = 0;
    write("VCU: Sleep triggered by CAN message.");
    // VCU_Alive 시그널 -> 0 : IL 메시지 전송 멈춤
    $VCU_Alive = 0;
  }
}

// 2. 시동 ON/OFF
on sysvar sysvar::FRONT::VCU::Ignition
{
  ign_msg.Ignition_Status = @this;
  output(ign_msg);
}

// 3. 기어 변경
on sysvar sysvar::FRONT::VCU::Gear
{
  gear = @this;
}
on message FZCU_OTA_VCU_MSG
{
  message VCU_OTAResult_STATUS_MSG vcu_otaresult_status_msg;
  vcu_otaresult_status_msg.VCU_OTAResult = 1;
  output(vcu_otaresult_status_msg);
  write("VCU OTA COMPLETED");
}


