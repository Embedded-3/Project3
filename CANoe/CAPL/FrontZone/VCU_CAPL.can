/*@!Encoding:65001*/
includes
{
  
}

variables
{
  msTimer loop;
  int timerCnt = 0;
  
  int motorRpm = 0;
  int targetIdleRpm = 800;
  int maxStartupRpm = 1500;
  int maxRpm = 6000;
  int state = 0; // 0: OFF, 1: STARTING, 2: READY
  int gearPos = 0; // 0:P, 1:R, 2:N, 3:D
  int prevGearPos = 0;
  int throttle = 0; // 0~10
  int brake = 0;    // 0~10
}

// 0. 시뮬레이션 시작 시 절전 진입
on start
{
  state = 0;
  write("VCU: Sleep mode entered.");
  setTimerCyclic(loop, 10);
}

// 0. Run 상태에서 보낼 주기 메세지
on timer loop
{
  if(state)
  {
    message VCU_AccPedal_CTL_10MSG acc_msg;
    message VCU_BrakePedal_CTL_10MSG brk_msg;
    message VCU_VehicleStart_STATUS_100MSG ign_msg;
    message VCU_Transmission_STATUS_100MSG trans_msg;
    
    timerCnt++;
    
    acc_msg.Accel_Pedal_Pos = @sysvar::FRONT::VCU::Accel_Pedal;
    brk_msg.Brake_Pedal_Pos = @sysvar::FRONT::VCU::Brake_Pedal;
    output(acc_msg);
    output(brk_msg);
    
    if(timerCnt % 10 == 0){
      // 시동
      ign_msg.Ignition_Status = @sysvar::FRONT::VCU::Ignition;
      output(ign_msg);
      
      // 기어
      trans_msg.Drive_Mode = @sysvar::FRONT::VCU::Drive_Mode;
      trans_msg.Gear_Position = @sysvar::FRONT::VCU::Gear;
      output(trans_msg);
      timerCnt = 0;
    }
  }
}

// 1. FZCU_WakeUp_CTL_MSG 메시지 수신 시 VCU 깨움
on message FZCU_WakeUp_CTL_MSG
{
  if (!state && this.FZCU_Wakeup)
  {
    state = 1;
    write("VCU: Wake-up triggered by CAN message.");
    // VCU_Alive 시그널 -> 1 : IL 메시지 전송 시작 (주기적 전송 포함)
    $VCU_Alive = 1;
  }
  else if(!this.FZCU_Wakeup)
  {
    state = 0;
    write("VCU: Sleep triggered by CAN message.");
    // VCU_Alive 시그널 -> 0 : IL 메시지 전송 멈춤
    $VCU_Alive = 0;
  }
}

// 2. 시동 ON/OFF
on sysvar sysvar::FRONT::VCU::Ignition
{
  message VCU_VehicleStart_STATUS_100MSG ign_msg;
  ign_msg.Ignition_Status = @this;
  output(ign_msg);
}

// 3. 기어 변경
on sysvar FRONT::VCU::Gear
{
  prevGearPos = gearPos;
  gearPos = @this;

  if (state == 2 && prevGearPos != gearPos)
  {
    if (gearPos == 1) {
      write("VCU: Gear shifted to Reverse");
    } else if (gearPos == 3) {
      write("VCU: Gear shifted to Drive");
    } else {
      write("VCU: Gear changed to Neutral/Park");
    }
  }
  
}

on message FZCU_OTA_VCU_MSG
{
  message VCU_OTAResult_STATUS_MSG vcu_otaresult_status_msg;
  vcu_otaresult_status_msg.VCU_OTAResult = 1;
  output(vcu_otaresult_status_msg);
  write("VCU OTA COMPLETED");
}

on sysvar FRONT::VCU::Accel_Pedal
{
  write("Accel : %d", @this);
  throttle = @this;
}

on sysvar FRONT::VCU::Brake_Pedal
{
  write("Brake : %d", @this);
  brake = @this;
}