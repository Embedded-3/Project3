/*@!Encoding:65001*/
includes
{
  
}

variables
{
  int isSleeping = 1; // 초기 상태는 절전
}

// 0. 시뮬레이션 시작 시 절전 진입
on start
{
  isSleeping = 1;
  write("MFS: Sleep mode entered.");
}

// 1. FZCU_WakeUp_CTL_MSG 메시지 수신 시 MFS 깨움
on message FZCU_WakeUp_CTL_MSG
{
  if (isSleeping && this.FZCU_Wakeup)
  {
    isSleeping = 0;
    write("MFS: Wake-up triggered by CAN message.");
    // MFS_Alive 시그널 -> 1 : IL 메시지 전송 시작 (주기적 전송 포함)
    $MFS_Alive = 1;   
  }
  if( !isSleeping && !this.FZCU_Wakeup)
  {
    isSleeping = 1;
    write("MFS: Sleep triggered by CAN message.");
    // MFS_Alive 시그널 -> 0 : IL 메시지 전송 멈춤
    $MFS_Alive = 0;
  }
}

on message FZCU_OTA_MFS_MSG
{
  message MFS_OTAResult_STATUS_MSG mfs_otaresult_status_msg;
  mfs_otaresult_status_msg.MFS_OTAResult = 1;
  output(mfs_otaresult_status_msg);
  write("MFS OTA COMPLETED");
}


