/*@!Encoding:65001*/
includes
{
  #include "../includes/eth_frame.can"
}

variables
{
  msTimer loopFlagInit5ms;
  msTimer loop20ms;
  
  int counter_20ms;
  
  byte wakeupFlag; // 0 : sleep 1 : wakeup
  byte otaFlag; // 1: ota processing
  
  ethernetPacket globalEthPkt;

  ethernetPacket LkasUdpMsg;
  ethernetPacket EsaUdpMsg;
  ethernetPacket AdbUdpMsg;
  ethernetPacket OtaFrontMsg;
  ethernetPacket OtaMiddleMsg;
  ethernetPacket OtaRearMsg;
  // ethernetPacket AliveUdpMsg;
  ethernetPacket WakeUpMsg;
  ethernetPacket MotorInfoMsg;
  ethernetPacket AdasStateMsg;
  ethernetPacket TransmissionMsg;
  ethernetPacket OtaAlarmMsg;

  // TX FRAME
  struct HpcFrontLkasFrame hpcFrontLkas20msFrame;
  struct HpcAllEsaFrame hpcAllEsa20msFrame;
  struct HpcMiddleAdbFrame hpcMiddleAdb20msFrame;
  struct HpcFrontOtaFrontFrame hpcFrontOtaFrontFrame;
  struct HpcMiddleOtaMiddleFrame hpcMiddleOtaMiddleFrame;
  struct HpcRearOtaRearFrame hpcRearOtaRearFrame;
  struct HpcAllWakeUpFrame hpcAllWakeUpFrame;
  struct HpcMiddleRpmInfoFrame hpcMiddleRpmInfo20msFrame;
  struct HpcMiddleAdasStateFrame hpcMiddleAdasState20msFrame;
  struct HpcMiddleTransmissionStateFrame hpcMiddleTransmissionState20msFrame;
  struct HpcMiddleOtaAlarmFrame hpcMiddleOtaAlarmFrame;
  
  int port_id;
  // RX FRAME
  struct RearHpcUssFrame rxUssFrame;
  struct FrontHpcCarControlFrame rxCarControlFrame;
  struct FrontHpcOtaResultFrame rxOtaFrontResultFrame;
  struct MiddleHpcOtaResultFrame rxOtaMiddleResultFrame;
  struct RearHpcOtaResultFrame rxOtaRearResultFrame;
  struct FrontHpcAdasOnOffFrame rxAdasOnOffFrame;
  struct MiddleHpcOtaAssignRejectFrame rxOtaAssignRejectFrame;
  struct MiddleHpcHeadLampStatusFrame rxHeadLampStatusFrame;
  struct MiddleHpcCanBusAliveFrame rxCanBusAliveFrame;
  struct RearHpcWheelInfoFrame rxWheelInfoFrame;
  struct FrontHpcWakeUpCallFrame rxWakeUpCallFrame;
  struct MiddleHpcObstacleDetectDistFrame rxObstacleDetectDistFrame;
  
  byte UssFrameReceived20ms;
  byte CarControlFrameReceived10ms;
  byte OtaFrontResultFrameReceived10ms;
  byte OtaMiddleResultFrameReceived10ms;
  byte OtaRearResultFrameReceived10ms;
  byte AdasOnOffFrameReceived10ms;
  byte OtaAssignRejectFrameReceived10ms;
  byte HeadLampStatusFrameReceived20ms;
  byte CanBusAliveFrameReceived20ms;
  byte WheelInfoFrameReceived20ms;
  byte WakeUpCallFrameReceived;
  byte ObstacleDetectDistFrameReceived;
  
  //====================HPC VARIABLES================//
  
  byte ADAS_OnOff_State;
  
  byte lkasTxSteeringAngle;
  
  // ESA HPC VARIABLES
  byte leftTurnSignal;
  byte rightTurnSignal;
  
  int obstacleDetectDistance;
  int leftRearUltraSoundVal;
  int rightRearUltraSoundVal;
  
  byte esaTxSteeringAngle;
  byte esaTxAlertSpeakerOutput;
  byte esaTxBrakeLightCTL;
  
  // ADB HPC VARIABLES
  int currentSteeringAngle;
  
  byte adbTxLeftHighBeamCTL; // currentSteeringAngle > 0 -> 오른쪽이동 -> 오른쪽 하이빔 끔
  byte adbTxRightHighBeamCTL; // currentSteeringAngle < 0 -> 왼쪽이동 -> 왼쪽 하이빔 끔
  byte adbTxLowBeamCTL; // 차선이동, 방향전환 시 LowBeam은 항상 키기
  byte adbTxUserSteeringAngle; 
  
  //===============수신값======================//
  byte currentAccelPedalPosition;
  byte currentBrakePedalPosition;
  byte currentGearPosition;
  byte currentIgnitionStatus;
  
  byte currentFrontOtaResult;
  byte currentMiddlOtaResult;
  byte currentRearOtaResult;
  
  byte currentTurnLeftStatus;
  byte currentTurnRightStatus;
  byte currentBrakeLightStatus;
  byte currentLowBeamOnOffStatus;
  byte currentHighBeamOnOffStatus;
  
  byte currentFrontCanChannelAlive;
  byte currentMiddleCanChannelAlive;
  byte currentRearCanChannelAlive;
  
  int Velocity;
  
  // 기타
  int i;   // 반복문 쓰는 용도
  dword Ota_Data[192] =
  {
    0x2010DA00,  0x74AFDA00,  0x78019140,  0x00FFD9FF,          
    0x008A8260,  0x7B1000F0,  0x0F0F10F0,  0x6CF19140,          
    0x00FFD9FF,  0x008A8270,  0x7B1000F0,  0x0F0F10F0,          
    0x6CF13BC0,  0x0C416D00,  0xDC006D00,  0x06018228,          
    0x1D00D200,  0xDA0074AF,  0x3C5EDA00,  0x78013C20,          
    0x54A05801,  0x3F0F0D00,  0x9140004F,  0xD944008A,          
    0x82748205,  0x82068207,  0x6D00D100,  0x3C0E9140,          
    0x004FD944,  0x008A8274,  0x3B000450,  0x3B000460,          
    0x3B000470,  0x6D00C300,  0x5801C21F,  0x78015801,          
    0x3B800000,  0x3F0FDE7F,  0xDA007801,  0x3C2054A0,          
    0x58013F0F,  0x0D009140,  0x004FD944,  0x008A8264,          
    0x82058206,  0x82076D00,  0xAA003C0E,  0x9140004F,          
    0xD944008A,  0x82643B00,  0x04503B00,  0x04603B00,          
    0x04706D00,  0x9C005801,  0xC21F7801,  0x58013B80,          
    0x00003F0F,  0xDE7FDA00,  0x78023C04,  0x5802C21F,          
    0x78025802,  0xBBB0710B,  0x06503F0F,  0xF97F54AF,          
    0xC21F74AF,  0x54A0DA08,  0x3FF0A17F,  0x3BC00C41,          
    0x6D006F00,  0xDA0074AF,  0x3C5EDA00,  0x78013C20,          
    0x54A05801,  0x3FF00D00,  0x9140004F,  0xD944008A,          
    0x82748205,  0x82068207,  0x6D006900,  0x3C0E9140,          
    0x004FD944,  0x008A8274,  0x3B000450,  0x3B000460,          
    0x3B000470,  0x6D005B00,  0x5801C21F,  0x78015801,          
    0x3B800000,  0x3F0FDE7F,  0xDA007801,  0x3C2054A0,          
    0x58013FF0,  0x0D009140,  0x004FD944,  0x008A8264,          
    0x82058206,  0x82076D00,  0x42003C0E,  0x9140004F,          
    0xD944008A,  0x82643B00,  0x04503B00,  0x04603B00,          
    0x04706D00,  0x34005801,  0xC21F7801,  0x58013B80,          
    0x00003F0F,  0xDE7FDA00,  0x78023C04,  0x5802C21F,          
    0x78025802,  0xBBB0710B,  0x06503F0F,  0xF97F54AF,          
    0xC21F74AF,  0x54A0DA08,  0x3FF0A17F,  0x3BC00C41,          
    0x6D000700,  0x028FC2F8,  0xDF0F2EFF,  0x00909100,          
    0x00FBD9FF,  0x0000D4FF,  0x48403C01,  0x3C01484F,          
    0x3C01A20F,  0x3F4FFDFF,  0x0090404F,  0x024F0B56,          
    0x1088027A,  0x7B100000,  0x0FF01000,  0x68103BC0,          
    0xDA406DFF,  0xE6FF40F4,  0x0BF81048,  0x6D002E00,          
    0x40F40BF9,  0x10486D00,  0x290040F4,  0x0BFA1048,          
    0x6D002400,  0x00908208,  0x3C0C9140,  0x004FD944,          
    0x008A8274,  0x82058206,  0x82076DFF,  0xD8FFC218,          
    0xDA083FF8,  0xF47F8208,  0x3C0C9140,  0x004FD944,          
    0x008A8264,  0x82058206,  0x82076DFF,  0xC8FFC218,          
    0xDA083FF8,  0xF47F0090,  0x404F0B45,  0x1088827A,          
    0x3C28DA01,  0x0FAF10F0,  0x269F6E12,  0xDA010F8F,          
    0x10F06CF1,  0x3B600440,  0x6DFFA3FF,  0x7B1000F0,          
    0x0F8F10F0,  0x6CF18254,  0x6DFF9BFF,  0x3C11DA01,          
    0x0F8F10F0,  0x6CF18254,  0x6DFF93FF,  0x7B1000F0,          
    0x0F8F10F0,  0x6CF13B60,  0x04406DFF,  0x8AFFC2FA,          
    0xFF0AD97F,  0x00900000,  0x00000000,  0x00000000,          
    0x00000000,  0x00000000,  0x00000000,  0x00000000          
  };
}

on start
{
  @ADAS::Python_OnOff = 0;
  initVariables();
  initAllUdpPackets();
}

// front zone 에서 LED 키게 하는 ota 명령
// 실제로는 ota_assign_reject 메시지 받고 해야함(아래에 적음)
on key 'f'
{
  sendLEDOtaMessage();
}

on sysvar sysvar::ADAS::Update_Alarm
{
  if (@ADAS::Update_Alarm == 1)
  {
    hpcMiddleOtaAlarmFrame.FrontZone_ECU_ID = 0;
    // MZCU MBCU ... -> MBCU 하드코딩
    hpcMiddleOtaAlarmFrame.MiddleZone_ECU_ID = (1 << 6);
    hpcMiddleOtaAlarmFrame.RearZone_ECU_ID = 0;
    hpcMiddleOtaAlarmFrame.Update_Byte_Size = @sysvar::ADAS::Update_Byte_Size;
    OtaAlarmMsg.SetData(0, hpcMiddleOtaAlarmFrame);
    OtaAlarmMsg.CompletePacket();
    output(OtaAlarmMsg);
    write("[TX] [hpc->mid] Ota Alarm Msg sent");
  }
}

on timer loopFlagInit5ms
{
  if(wakeupFlag == 0) return;
  
  UssFrameReceived20ms = 0;
  CarControlFrameReceived10ms = 0;
  OtaFrontResultFrameReceived10ms = 0;
  OtaMiddleResultFrameReceived10ms = 0;
  OtaRearResultFrameReceived10ms = 0;
  AdasOnOffFrameReceived10ms = 0;
  OtaAssignRejectFrameReceived10ms = 0;
  HeadLampStatusFrameReceived20ms = 0;
  CanBusAliveFrameReceived20ms = 0;
  WheelInfoFrameReceived20ms = 0;
  WakeUpCallFrameReceived = 0;
  ObstacleDetectDistFrameReceived = 0;
}

on timer loop20ms
{
  
  if(wakeupFlag == 0) return;
  counter_20ms++;
  
  
  if(@sysvar::ADAS::Python_OnOff==0){
    if(ADAS_OnOff_State == 1){
      @sysvar::ADAS::ADAS_OnOff = 1;
      if(@sysvar::ADAS::LKAS_OnOff||@sysvar::ADAS::ESA_OnOff||@sysvar::ADAS::ADB_OnOff){
        if(leftTurnSignal || rightTurnSignal){
          @sysvar::ADAS::LKAS_OnOff = 0;
          @sysvar::ADAS::ESA_OnOff = 1;
          @sysvar::ADAS::ADB_OnOff = 1; 
        }
        else{
          @sysvar::ADAS::LKAS_OnOff = 1;
          @sysvar::ADAS::ESA_OnOff = 0;
          @sysvar::ADAS::ADB_OnOff = 1; 
        }
      }
      else{ // 초기 1 setting 시 init
        @sysvar::ADAS::LKAS_OnOff = 1;
        @sysvar::ADAS::ESA_OnOff = 0;
        @sysvar::ADAS::ADB_OnOff = 1; 
      }
    }
    else{
      @sysvar::ADAS::ADAS_OnOff = 0;
      @sysvar::ADAS::LKAS_OnOff = 0;
      @sysvar::ADAS::ESA_OnOff = 0;
      @sysvar::ADAS::ADB_OnOff = 0; 
    }
    
    write("HPC ADAS [%d]", ADAS_OnOff_State);
    if (@sysvar::ADAS::LKAS_OnOff) // LKAS ON
    {
      write("HPC %d", currentSteeringAngle);
      if (!leftTurnSignal && !rightTurnSignal)
      {
        // Test 시나리오 넣어야함. 일단 반대 방향으로 틀어진값 보정하도록함. 
        lkasTxSteeringAngle = -currentSteeringAngle; // ====================>> 여기도 호준이형 값 받은걸로 수정.
      }
      else
      {
        lkasTxSteeringAngle = currentSteeringAngle;
      }
    }
    
    if (@sysvar::ADAS::ESA_OnOff) // ESA ON
    {
      if (leftTurnSignal && leftRearUltraSoundVal <= obstacleDetectDistance && currentSteeringAngle < 0)
      {
        esaTxSteeringAngle = -currentSteeringAngle; // currentSteeringAngle => 호준이형 값 환경변수
        esaTxAlertSpeakerOutput = 1;
        //esaTxBrakeLightCTL = 1;
      }
      else if (rightTurnSignal && rightRearUltraSoundVal <= obstacleDetectDistance && currentSteeringAngle > 0)
      {
        esaTxSteeringAngle = -currentSteeringAngle;
        esaTxAlertSpeakerOutput = 1;
        //esaTxBrakeLightCTL = 1;
      }
      else
      {
        esaTxSteeringAngle = currentSteeringAngle;
        esaTxAlertSpeakerOutput = 0;
        //esaTxBrakeLightCTL = currentBrakeLightStatus;
      }
    }
    if (@sysvar::ADAS::ADB_OnOff) // ADB ON
    {    
       if (currentSteeringAngle > 5) // 우회전을 하면 오른쪽 하이빔 꺼짐
       {
         adbTxRightHighBeamCTL = 0;
         adbTxLeftHighBeamCTL = 1;
         adbTxLowBeamCTL = 1;
       }
       else if (currentSteeringAngle < -5) // 좌회전을 하면 왼쪽 하이빔 꺼짐
       {
         adbTxRightHighBeamCTL = 1;
         adbTxLeftHighBeamCTL = 0;
         adbTxLowBeamCTL = 1;
       }
       else
       { 
         adbTxRightHighBeamCTL = currentHighBeamOnOffStatus;
         adbTxLeftHighBeamCTL = currentHighBeamOnOffStatus;
         adbTxLowBeamCTL = currentLowBeamOnOffStatus;
       }
       adbTxUserSteeringAngle = currentSteeringAngle;
    }  
    //================ADAS Simulation CALCULATE END================//
  }
  else // Python 켜졌을 때 호준이형 로직
  {
      @sysvar::ADAS::Car_Speed = Velocity;
      @sysvar::ADAS::USS_Detection = leftRearUltraSoundVal;
      @sysvar::ADAS::USS_Distance = obstacleDetectDistance;
    
      @sysvar::ADAS::ADAS_OnOff = ADAS_OnOff_State;
      
      if(@sysvar::ADAS::LKAS_OnOff==1)
      {
        lkasTxSteeringAngle = @sysvar::ADAS::ADAS_Steering;
      }
      else if(@sysvar::ADAS::ESA_OnOff == 1)
      {
        esaTxSteeringAngle = @sysvar::ADAS::ADAS_Steering;
        esaTxAlertSpeakerOutput = @sysvar::ADAS::ESA_Alert;
      }      
      if(@sysvar::ADAS::ADB_OnOff==1)
      {
        adbTxRightHighBeamCTL = @sysvar::ADAS::ADB_Right;
        adbTxLeftHighBeamCTL = @sysvar::ADAS::ADB_Left;
      }
      adbTxLowBeamCTL = 1;
        
      adbTxUserSteeringAngle = currentSteeringAngle;
    }  
    //================ADAS CALCULATE END================//
 
  if(@sysvar::ADAS::LKAS_OnOff){
    hpcFrontLkas20msFrame.LKAS_Steering_Angle = lkasTxSteeringAngle;
    LkasUdpMsg.udp.setData(0, hpcFrontLkas20msFrame);
    LkasUdpMsg.CompletePacket();
    output(LkasUdpMsg);
    write("[TX] [hpc->front] Lkas packet sent at %d ms", 20 * counter_20ms);
  }
  if(@sysvar::ADAS::ESA_OnOff){
    hpcAllEsa20msFrame.ESA_Steering_Angle  = esaTxSteeringAngle; 
    hpcAllEsa20msFrame.AlertSpeaker_Output = esaTxAlertSpeakerOutput; 
    hpcAllEsa20msFrame.BrakeLight_CTL      = esaTxBrakeLightCTL; 
    EsaUdpMsg.udp.setData(0, hpcAllEsa20msFrame);
    EsaUdpMsg.CompletePacket();
    output(EsaUdpMsg);
    write("[TX] [hpc->All] Esa packet sent at %d ms", 20 * counter_20ms);
  }
  if(@sysvar::ADAS::ADB_OnOff){
    hpcMiddleAdb20msFrame.Left_HighBeam_CTL  = adbTxLeftHighBeamCTL; 
    hpcMiddleAdb20msFrame.Right_HighBeam_CTL = adbTxRightHighBeamCTL; 
    hpcMiddleAdb20msFrame.LowBeam_CTL        = adbTxLowBeamCTL;
    AdbUdpMsg.udp.setData(0, hpcMiddleAdb20msFrame);
    AdbUdpMsg.CompletePacket();
    output(AdbUdpMsg);
    write("[TX] [hpc->mid] Adb packet sent at %d ms", 20 * counter_20ms);
  }
  
  hpcMiddleRpmInfo20msFrame.VCU_RPM = rxWheelInfoFrame.RPM;
  hpcMiddleRpmInfo20msFrame.MCU_Velocity = rxWheelInfoFrame.Velocity;
  MotorInfoMsg.udp.setData(0, hpcMiddleRpmInfo20msFrame);
  MotorInfoMsg.CompletePacket();
  output(MotorInfoMsg);
  write("[TX] [hpc->mid] VCU_RPM: %d, MCU_Velocity : %d", hpcMiddleRpmInfo20msFrame.VCU_RPM, hpcMiddleRpmInfo20msFrame.MCU_Velocity);

  hpcMiddleAdasState20msFrame.LKAS_On_Off = @sysvar::ADAS::LKAS_OnOff;
  hpcMiddleAdasState20msFrame.ESA_On_Off = @sysvar::ADAS::ESA_OnOff;
  hpcMiddleAdasState20msFrame.ADB_On_Off = @sysvar::ADAS::ADB_OnOff;
  AdasStateMsg.udp.SetData(0, hpcMiddleAdasState20msFrame);
  AdasStateMsg.CompletePacket();
  output(AdasStateMsg);
  write("[TX] [hpc->mid] ADAS STATE : %d %d %d", hpcMiddleAdasState20msFrame.LKAS_On_Off,
                hpcMiddleAdasState20msFrame.ESA_On_Off, hpcMiddleAdasState20msFrame.ADB_On_Off);

  hpcMiddleTransmissionState20msFrame.Gear_Position = currentGearPosition;
  TransmissionMsg.udp.SetData(0, hpcMiddleTransmissionState20msFrame);
  TransmissionMsg.CompletePacket();
  output(TransmissionMsg);
  write("[TX] [hpc->mid] gear position : %d", hpcMiddleTransmissionState20msFrame.Gear_Position);
}

on ethernetPacket *
{
  ip_Endpoint endPointDst;

  this.GetDestinationIPEndpoint(endPointDst);
  
  port_id = (int)(endPointDst.PortNumber - HPC_RX_PORT_BASE);
  switch (port_id) 
  {
    case HPC_USS_RX_PORT_ID:
      if (UssFrameReceived20ms) break;
      UssFrameReceived20ms = 1;
      this.udp.GetData(0, rxUssFrame);
      leftRearUltraSoundVal = rxUssFrame.LeftRear_UltraSoundVal;
      rightRearUltraSoundVal = rxUssFrame.RightRear_UltraSoundVal;
      write("[RX] [rear->hpc] USS : %d / %d", rxUssFrame.LeftRear_UltraSoundVal, rxUssFrame.RightRear_UltraSoundVal);
      break;
    case HPC_CARCONTROL_RX_PORT_ID:
      if (CarControlFrameReceived10ms) break;
      CarControlFrameReceived10ms = 1;
      this.udp.GetData(0, rxCarControlFrame);
      currentSteeringAngle = rxCarControlFrame.User_Steering_Angle;
      currentAccelPedalPosition = rxCarControlFrame.Accel_Pedal_Pos;
      currentBrakePedalPosition = rxCarControlFrame.Brake_Pedal_Pos;
      currentGearPosition = rxCarControlFrame.Gear_Position;
      currentIgnitionStatus = rxCarControlFrame.Ignition_Status;
      write("[RX] [front->hpc] SteeringAngle : %u, AccelPedalPos : %u, BrakePedal : %u, GearPosition: %u, Ignition : %u",
            rxCarControlFrame.User_Steering_Angle, rxCarControlFrame.Accel_Pedal_Pos, rxCarControlFrame.Brake_Pedal_Pos,
            rxCarControlFrame.Gear_Position, rxCarControlFrame.Ignition_Status);
      break;
    case HPC_OTARESULT_FRONT_RX_PORT_ID:
      if (OtaFrontResultFrameReceived10ms) break;
      OtaFrontResultFrameReceived10ms = 1;
      this.udp.GetData(0, rxOtaFrontResultFrame);
      currentFrontOtaResult = rxOtaFrontResultFrame.ECU_OTA_Result;
      write("[RX] [front->hpc] Front OTA Result : %d", rxOtaFrontResultFrame.ECU_OTA_Result);
      break;
    case HPC_OTARESULT_MIDDLE_RX_PORT_ID:
      if (OtaMiddleResultFrameReceived10ms) break;
      OtaMiddleResultFrameReceived10ms = 1;
      this.udp.GetData(0, rxOtaMiddleResultFrame);
      currentMiddlOtaResult = rxOtaMiddleResultFrame.ECU_OTA_Result;
      write("[RX] [middle->hpc] Middle OTA Result : %d", rxOtaMiddleResultFrame.ECU_OTA_Result);
      break;
    case HPC_OTARESULT_REAR_RX_PORT_ID:
      if (OtaRearResultFrameReceived10ms) break;
      OtaRearResultFrameReceived10ms = 1;
      this.udp.GetData(0, rxOtaRearResultFrame);
      currentRearOtaResult = rxOtaRearResultFrame.ECU_OTA_Result;
      write("[RX] [rear->hpc] Rear OTA Result : %d", rxOtaRearResultFrame.ECU_OTA_Result);
      break;
    case HPC_ADAS_ONOFF_RX_PORT_ID:
      if (AdasOnOffFrameReceived10ms) break;
      AdasOnOffFrameReceived10ms = 1;
      this.udp.GetData(0, rxAdasOnOffFrame);
      ADAS_OnOff_State = rxAdasOnOffFrame.ADAS_On_Off_Status;
      write("[RX] [front->hpc] ADAS state : %d", rxAdasOnOffFrame.ADAS_On_Off_Status);
      break;
    case HPC_OTA_ASSIGN_REJECT_RX_PORT_ID:
      if (OtaAssignRejectFrameReceived10ms) break;
      OtaAssignRejectFrameReceived10ms = 1;
      this.udp.GetData(0, rxOtaAssignRejectFrame);
      write("[RX] [middle->hpc] OTA assign : %d", rxOtaAssignRejectFrame.UpdateAcceptDecline_Signal);
      
      // ota assign 했으므로 ota 실시
      if (rxOtaAssignRejectFrame.UpdateAcceptDecline_Signal)
      {
        sendLEDOtaMessage();
      }
      break;
    case HPC_HEADLAMP_STATUS_RX_PORT_ID:
      if (HeadLampStatusFrameReceived20ms) break;
      HeadLampStatusFrameReceived20ms = 1;
      this.udp.GetData(0, rxHeadLampStatusFrame);
      leftTurnSignal = (rxHeadLampStatusFrame.LeftFront_RightFront_BrakeLight_LowBeam_HighBeam_Status & (1 << 7)) >> 7;
      rightTurnSignal = (rxHeadLampStatusFrame.LeftFront_RightFront_BrakeLight_LowBeam_HighBeam_Status & (1 << 6)) >> 6;
      
      currentTurnLeftStatus = (rxHeadLampStatusFrame.LeftFront_RightFront_BrakeLight_LowBeam_HighBeam_Status & (1 << 7)) >> 7;
      currentTurnRightStatus = (rxHeadLampStatusFrame.LeftFront_RightFront_BrakeLight_LowBeam_HighBeam_Status & (1 << 6)) >> 6;
      currentBrakeLightStatus = (rxHeadLampStatusFrame.LeftFront_RightFront_BrakeLight_LowBeam_HighBeam_Status & (1 << 5)) >> 5;
      currentLowBeamOnOffStatus = (rxHeadLampStatusFrame.LeftFront_RightFront_BrakeLight_LowBeam_HighBeam_Status & (1 << 4)) >> 4;
      currentHighBeamOnOffStatus = (rxHeadLampStatusFrame.LeftFront_RightFront_BrakeLight_LowBeam_HighBeam_Status & (1 << 5)) >> 5;
      
      write("[RX] [middle->hpc] CarState : %d, LeftHighBeam : %d, RightHighBeam : %d", 
            rxHeadLampStatusFrame.LeftFront_RightFront_BrakeLight_LowBeam_HighBeam_Status,
            rxHeadLampStatusFrame.LeftHighBeamStatus,
            rxHeadLampStatusFrame.RightHighBeamStatus);
      break;
    case HPC_CANBUS_ALIVE_RX_PORT_ID:
      if (CanBusAliveFrameReceived20ms) break;
      CanBusAliveFrameReceived20ms = 1;
      this.udp.GetData(0, rxCanBusAliveFrame);
      currentFrontCanChannelAlive = rxCanBusAliveFrame.FrontZoneCanBus_Alive;
      currentMiddleCanChannelAlive = rxCanBusAliveFrame.MiddleZoneCanBus_Alive;
      currentRearCanChannelAlive = rxCanBusAliveFrame.RearZoneCanBus_Alive;
      write("[RX] [middle->hpc] CAN alive.. Front:%d, Middle:%d, Rear:%d",
            rxCanBusAliveFrame.FrontZoneCanBus_Alive,
            rxCanBusAliveFrame.MiddleZoneCanBus_Alive,
            rxCanBusAliveFrame.RearZoneCanBus_Alive);
      break;
    case HPC_WHEEL_INFO_RX_PORT_ID:
      if (WheelInfoFrameReceived20ms) break;
      WheelInfoFrameReceived20ms = 1;
      this.udp.GetData(0, rxWheelInfoFrame);
      Velocity = rxWheelInfoFrame.Velocity;
      write("[RX] [rear->hpc] Velocity : %d", rxWheelInfoFrame.Velocity);    
      break;
    case HPC_WAKEUPCALL_RX_PORT_ID:
      if (WakeUpCallFrameReceived) break;
      WakeUpCallFrameReceived = 1;
      this.udp.GetData(0, rxWakeUpCallFrame);
      wakeupFlag = rxWakeUpCallFrame.WakeUp_Call;
      write("[RX] [front->hpc] wakeup call frame received");
      if(!rxWakeUpCallFrame.WakeUp_Call){
        WakeUpCallFrameReceived = 0;
      }
      // WakeUp msg 보내기
      hpcAllWakeUpFrame.WakeUp_ALL_ECU = rxWakeUpCallFrame.WakeUp_Call;
      WakeUpMsg.udp.SetData(0, hpcAllWakeUpFrame);
      WakeUpMsg.CompletePacket();
      output(WakeUpMsg);
      write("[TX] [hpc->ALL] wakeup msg sent at beginning");
      break;
    case HPC_OBSTACLE_DETECT_DIST_TX_PORT_ID:
      if (ObstacleDetectDistFrameReceived) break;
      ObstacleDetectDistFrameReceived = 1;
      this.udp.GetData(0, rxObstacleDetectDistFrame);
      obstacleDetectDistance = rxObstacleDetectDistFrame.ObstacleDetectDistance;
      write("[RX] [middle->hpc] ObstacleDetectDist : %d ", obstacleDetectDistance);
      break;
    default:
      break;
  }
  
}


void initUdpPacket(char TX_MAC_ADDR[], char RX_MAC_ADDR[],
                  char TX_IP_ADDR[], char RX_IP_ADDR[],
                  long TX_PORT_BASE, long RX_PORT_BASE,
                  long TX_PORT_ID, long RX_PORT_ID)
{
  globalEthPkt.source = ethGetMacAddressAsNumber(TX_MAC_ADDR);
  globalEthPkt.destination = ethGetMacAddressAsNumber(RX_MAC_ADDR);
  globalEthPkt.udp.init();
  globalEthPkt.type = 0x0800;
  globalEthPkt.Length = 104;
  globalEthPkt.udp.length = 64;
  globalEthPkt.ipv4.source.ParseAddress(TX_IP_ADDR);
  globalEthPkt.ipv4.destination.ParseAddress(RX_IP_ADDR);
  globalEthPkt.udp.source = TX_PORT_BASE + TX_PORT_ID;
  globalEthPkt.udp.destination = RX_PORT_BASE + RX_PORT_ID;
}

on key 'q'
{
  sendLEDOtaMessage();
}

void sendLEDOtaMessage()
{
  qword ota_value;
  hpcMiddleOtaMiddleFrame.ECU_Select = 0x6;
  hpcMiddleOtaMiddleFrame.Total_dword = 96;
  hpcMiddleOtaMiddleFrame.Start_dword_Offset = 0;
  hpcMiddleOtaMiddleFrame.End_dword_Offset = 95;
  for (i = 0; i < 192; i += 2)
  {
    ota_value = 0;
    ota_value = Ota_Data[i]; 
    ota_value = (ota_value << 32);
    ota_value |= Ota_Data[i+1];
    hpcMiddleOtaMiddleFrame.Data[i / 2] = ota_value;
  }
  i = 0;
  OtaMiddleMsg.udp.setData(0, hpcMiddleOtaMiddleFrame);
  OtaMiddleMsg.CompletePacket();
  output(OtaMiddleMsg);
  write("[TX] [hpc->mid] OtaMiddleMsg sent at %d ms", 20 * counter_20ms); 
}

void initVariables()
{
  i = 0;
  counter_20ms = 0;
  wakeupFlag = 0;
  
  ADAS_OnOff_State = 0;
  
  obstacleDetectDistance = 30; // 기본값 30 (수정필요)
  leftRearUltraSoundVal = 100;
  rightRearUltraSoundVal = 100;
  
  currentSteeringAngle = 0;
  currentAccelPedalPosition = 0;
  currentBrakePedalPosition = 0;
  currentGearPosition = 0;
  currentIgnitionStatus = 0;
  
  currentFrontOtaResult = 0;
  currentMiddlOtaResult = 0;
  currentRearOtaResult = 0;
  
  currentTurnLeftStatus = 0;
  currentTurnRightStatus = 0;
  currentBrakeLightStatus = 0;
  currentLowBeamOnOffStatus = 0;
  currentHighBeamOnOffStatus = 0;
  
  currentFrontCanChannelAlive = 0;
  currentMiddleCanChannelAlive = 0;
  currentRearCanChannelAlive = 0;
  
  Velocity = 0;
  
  setTimerCyclic(loop20ms, 20);
  setTimerCyclic(loopFlagInit5ms, 5);
  
  OtaFrontResultFrameReceived10ms = 0;
  OtaMiddleResultFrameReceived10ms = 0;
  OtaRearResultFrameReceived10ms = 0;
  AdasOnOffFrameReceived10ms = 0;
  OtaAssignRejectFrameReceived10ms = 0;
  UssFrameReceived20ms = 0;
  HeadLampStatusFrameReceived20ms = 0;
  CanBusAliveFrameReceived20ms = 0;
  WheelInfoFrameReceived20ms = 0;
  WakeUpCallFrameReceived = 0;
  ObstacleDetectDistFrameReceived = 0; 
}

void initAllUdpPackets()
{
  initUdpPacket(HPC_MAC_ADDR, FZCU_MAC_ADDR, HPC_IP_ADDR, FZCU_IP_ADDR, 
                HPC_TX_PORT_BASE, FRONT_RX_PORT_BASE, HPC_LKAS_TX_PORT_ID, FRONT_LKAS_RX_PORT_ID);
  LkasUdpMsg = globalEthPkt;
  
  initUdpPacket(HPC_MAC_ADDR, BROADCAST_MAC_ADDR, HPC_IP_ADDR, BROADCAST_IP_ADDR,
                HPC_TX_PORT_BASE, ALLCAN_RX_PORT_BASE, HPC_ESA_TX_PORT_ID, ALLCAN_ESA_RX_PORT_ID);
  EsaUdpMsg = globalEthPkt;
  
  initUdpPacket(HPC_MAC_ADDR, MZCU_MAC_ADDR, HPC_IP_ADDR, MZCU_IP_ADDR,
                HPC_TX_PORT_BASE, MIDDLE_RX_PORT_BASE, HPC_ADB_TX_PORT_ID, MIDDLE_ADB_RX_PORT_ID);
  AdbUdpMsg = globalEthPkt;
  
  initUdpPacket(HPC_MAC_ADDR, FZCU_MAC_ADDR, HPC_IP_ADDR, FZCU_IP_ADDR,
                HPC_TX_PORT_BASE, FRONT_RX_PORT_BASE, HPC_OTAFRONT_TX_PORT_ID, FRONT_OTAFRONT_RX_PORT_ID);
  globalEthPkt.Length = 1500;
  globalEthPkt.udp.length = 1472;
  OtaFrontMsg = globalEthPkt;
  
  initUdpPacket(HPC_MAC_ADDR, MZCU_MAC_ADDR, HPC_IP_ADDR, MZCU_IP_ADDR,
                HPC_TX_PORT_BASE, MIDDLE_RX_PORT_BASE, HPC_OTAMIDDLE_TX_PORT_ID, MIDDLE_OTAMIDDLE_RX_PORT_ID);
  globalEthPkt.Length = 1500;
  globalEthPkt.udp.length = 1472;
  OtaMiddleMsg = globalEthPkt;

  initUdpPacket(HPC_MAC_ADDR, RZCU_MAC_ADDR, HPC_IP_ADDR, RZCU_IP_ADDR,
                HPC_TX_PORT_BASE, REAR_RX_PORT_BASE, HPC_OTAREAR_TX_PORT_ID, REAR_OTAREAR_RX_PORT_ID);
  globalEthPkt.Length = 1500;
  globalEthPkt.udp.length = 1472;
  OtaRearMsg = globalEthPkt;
  
  initUdpPacket(HPC_MAC_ADDR, BROADCAST_MAC_ADDR, HPC_IP_ADDR, BROADCAST_IP_ADDR, 
                HPC_TX_PORT_BASE, ALLCAN_RX_PORT_BASE, HPC_WAKEUP_TX_PORT_ID, ALLCAN_WAKEUP_RX_PORT_ID);
  WakeUpMsg = globalEthPkt;
  
  initUdpPacket(HPC_MAC_ADDR, MZCU_MAC_ADDR, HPC_IP_ADDR, MZCU_IP_ADDR,
                HPC_TX_PORT_BASE, MIDDLE_RX_PORT_BASE, HPC_RPMINFO_TX_PORT_ID, MIDDLE_RPMINFO_RX_PORT_ID);
  MotorInfoMsg = globalEthPkt; 

  initUdpPacket(HPC_MAC_ADDR, MZCU_MAC_ADDR, HPC_IP_ADDR, MZCU_IP_ADDR,
                HPC_TX_PORT_BASE, MIDDLE_RX_PORT_BASE, HPC_ADAS_STATE_TX_PORT_ID, MIDDLE_ADAS_STATE_RX_PORT_ID);
  AdasStateMsg = globalEthPkt;
  
  initUdpPacket(HPC_MAC_ADDR, MZCU_MAC_ADDR, HPC_IP_ADDR, MZCU_IP_ADDR,
                HPC_TX_PORT_BASE, MIDDLE_RX_PORT_BASE, HPC_TRANSMISSION_STATE_TX_PORT_ID, MIDDLE_TRANSMISSION_STATE_RX_PORT_ID);
  TransmissionMsg = globalEthPkt;
  
  initUdpPacket(HPC_MAC_ADDR, MZCU_MAC_ADDR, HPC_IP_ADDR, MZCU_IP_ADDR,
                HPC_TX_PORT_BASE, MIDDLE_RX_PORT_BASE, HPC_OTA_ALARM_TX_PORT_ID, MIDDLE_OTA_ALARM_RX_PORT_ID);
  OtaAlarmMsg = globalEthPkt;
}
